## conf/machine/sa525m.conf
```bitbake
#@TYPE: Machine
#@NAME: SA525M
#@DESCRIPTION: Machine configuration for SA525M NAND

require conf/machine/include/sa525m.inc

# MACHINE_FEATURES ##
MACHINE_FEATURES += "nand-boot tele-squashfs-ubi ckmhal_kmlite qti-nad-core"

# Formats of root filesystem images
IMAGE_FSTYPES = "ubi"

# Sizes for UBI volumes
SYSTEM_VOLUME_SIZE   = "150MiB"
CACHE_VOLUME_SIZE    = "10MiB"
SYSTEMRW_VOLUME_SIZE = "6MiB"
PERSIST_VOLUME_SIZE  = "6MiB"
MODEM_VOLUME_SIZE = "110MiB"

# Sizes for UBI squashfs volumes
SYSTEM_SQUASHFS_VOLUME_SIZE = "80MiB"
MODEM_SQUASHFS_VOLUME_SIZE = "90MiB"
TELAF_SQUASHFS_VOLUME_SIZE = "10MiB"
TELAF_APP_VOLUME_SIZE = "20MiB"
VM_BOOTSYS_VOLUME_SIZE = "80MiB"

# UBI arguments
UBINIZE_ARGS = "-m 4096 -p 256KiB -s 4096"
MKUBIFS_ARGS = "-m 4096 -e 253952 -c 2146 -F"

# Disable autosuspend for USB peripheral mode
MACHINE_SUPPORTS_USB_AUTOSUSPEND = "False"

# File indicating firmware residing places on device.
MACHINE_FILESMAP_CONF = "sa525m-filesmap"
```

## conf/machine/scuba-32.conf
```bitbake
#@TYPE: Machine
#@NAME: scuba-32 (32-bit)
#@DESCRIPTION: Machine configuration for scuba

require conf/machine/include/scuba.inc
DEFAULTTUNE = "armv7ahf-neon"
#The type of kernel to build for a device
KERNEL_IMAGETYPE = "zImage-dtb"
KERNEL_BASE        = "0x40000000"
MACHINE_SUPPORTS_DTBO  = "True"
KERNEL_DTB_NAMES = "vendor/qcom/scuba-iot.dtb vendor/qcom/monaco.dtb"
KERNEL_CONFIG ?= "vendor/monaco_defconfig"
KERNEL_CONFIG_qti-distro-debug ?= "vendor/monaco-debug_defconfig"
KERNEL_CMD_PARAMS = "noinitrd init=/sbin/init rootwait root=/dev/mmcblk1p13 rootfstype=ext4 ro systemd.setenv="SLOT_SUFFIX"="_a" console=ttyMSM0,115200,n8 no_console_suspend=1"

# Conf with partition entries required for machine.
MACHINE_PARTITION_CONF = "scuba-partition.conf"

# filesystem configurations to be applied on image.
MACHINE_FSCONFIG_CONF = "scuba-fsconfig.conf"

# File indicating firmware residing places on device.
MACHINE_FILESMAP_CONF = "bengal-filesmap"

# Enable qti-ab-boot feature without OTA package
GENERATE_AB_OTA_PACKAGE = "0"

#list of hardware features that MACHINE is capable of supporting
MACHINE_FEATURES += "drm dm-verity-none qti-ab-boot"

#Need for compiling UEFI for aarch64
require conf/multilib.conf
MULTILIBS = "multilib:lib64"
DEFAULTTUNE_virtclass-multilib-lib64 = "aarch64"
TARGET_VENDOR_virtclass-multilib-lib64="-oe"
```

## conf/machine/scuba-auto.conf
```bitbake
#@TYPE: Machine
#@NAME: scuba-auto
#@DESCRIPTION: Machine configuration for QTI scuba-auto eMMC

require conf/machine/include/sa410m.inc

KERNEL_CONFIG = "vendor/scuba_auto_defconfig"
KERNEL_CONFIG_qti-distro-debug = "vendor/scuba_auto-debug_defconfig"

KERNEL_PREBUILT_PATH = "${WORKSPACE}/kernel-5.15/out/msm-kernel-scuba_auto-${KERNEL_VARIANT}defconfig/dist"
KERNEL_OUT_PATH = "${WORKSPACE}/kernel-5.15/out/msm-kernel-scuba_auto-${KERNEL_VARIANT}defconfig"
KERNEL_BUILD_CONFIG = "msm-kernel/build.config.msm.scuba_auto"

# MACHINE_FEATURES ##
MACHINE_FEATURES += "emmc-boot"

# Sizes for EXT4 (in bytes)
SYSTEM_SIZE_EXT4   = "536870912"
USERDATA_SIZE_EXT4 = "7243620352"
CACHE_SIZE_EXT4 = "31457280"

SDCARD_DEVICE = "mmcblk1p1"

# Formats of root filesystem images
IMAGE_FSTYPES += "ext4"

# filesystem configurations to be applied on image.
MACHINE_FSCONFIG_CONF = "sa410m-fsconfig.conf"

# File indicating firmware residing places on device.
MACHINE_FILESMAP_CONF = "sa410m-filesmap"

# Conf with partition entries required for machine.
MACHINE_PARTITION_CONF = "sa410m-partition.conf"
```

## conf/machine/scuba.conf
```bitbake
#@TYPE: Machine
#@NAME: scuba (64-bit)
#@DESCRIPTION: Machine configuration for scuba

require conf/machine/include/scuba.inc

#The type of kernel to build for a device
KERNEL_IMAGETYPE = "Image.gz"
KERNEL_BASE        = "0x80000000"
KERNEL_TAGS_OFFSET = "0x81900000"

KERNEL_CONFIG ?= "vendor/genericarmv8-64_defconfig"

KERNEL_CMD_PARAMS = ""

# Conf with partition entries required for machine.
MACHINE_PARTITION_CONF = "scuba-partition.conf"

# filesystem configurations to be applied on image.
MACHINE_FSCONFIG_CONF = "scuba-fsconfig.conf"

# Enable qti-ab-boot feature without OTA package
GENERATE_AB_OTA_PACKAGE = "0"

#list of hardware features that MACHINE is capable of supporting
MACHINE_FEATURES += "dm-verity-none qti-ab-boot"
```

## conf/machine/sdxlemur.conf
```bitbake
#@TYPE: Machine
#@NAME: SDXLEMUR
#@DESCRIPTION: Machine configuration for QTI MTP with SDXLEMUR
BASEMACHINE ?= "sdxlemur"
require conf/machine/include/basemachine.inc

SOC_FAMILY ?= "mdm9x50"
include conf/machine/include/tune-cortexa7.inc

PREFERRED_PROVIDER_virtual/kernel = "linux-msm"
PREFERRED_VERSION_linux-msm = "5.4"
PREFERRED_VERSION_linux-msm-headers ?= "5.4"

LLVM_VERSION = "8.0"
SERIAL_CONSOLES ?= '115200;ttyMSM0'
KERNEL_IMAGETYPE = "zImage-dtb"
KERNEL_BASE = "0x80000000"
KERNEL_TAGS_OFFSET = "0x82000000"
KERNEL_CONFIG ?= "vendor/sdxlemur_defconfig"
KERNEL_CONFIG_qti-distro-debug ?= "vendor/sdxlemur-debug_defconfig"
KERNEL_CMD_PARAMS = "ro rootwait console=ttyMSM0,115200,n8 androidboot.hardware=qcom msm_rtb.filter=0x237 androidboot.console=ttyMSM0 lpm_levels.sleep_disabled=1 firmware_class.path=/lib/firmware/updates service_locator.enable=1 net.ifnames=0 atlantic_fwd.rx_ring_size=512 atlantic_fwd.rx_linear=1 pcie_ports=compat pci=pcie_bus_perf"

KERNEL_DYNAMIC_DEFCONFIG = "True"

EXTRA_IMAGEDEPENDS += "edk2"

# TODO: Temporary change to override BB_SIGNATURE_HANDLER set in local.conf.
# Other machines are already supporting OEEquivHash as hashing signature.
# Fix build issues observed in this machine and remove this override.
BB_SIGNATURE_HANDLER = "OEBasicHash"

MACHINE_FEATURES += "nand-boot kernel26 keyboard ipa-offload qti-sdx qti-location qti-audio qti-display qti-bluetooth le_qseecom qti-wifi qti-recovery cmnlib-preload norpmb_listener nossd_listener qti-embms qti-ssdk dm-verity-none qwesd qti-modem "

MACHINE_MNT_POINTS = " \
    /firmware \
    /persist \
    /cache \
    /data \
    /systemrw \
"

PAGE_SIZE ?= '4096'
UBINIZE_ARGS ?= "-m 4096 -p 256KiB -s 4096"
MKUBIFS_ARGS ?= "-m 4096 -e 253952 -c 2146 -F"

# Sysfs ubi volume sizes
SYSTEM_VOLUME_SIZE ?= "110MiB"
# rootfs volume size for 1GB storage
SYSTEM_VOLUME_SIZE_G ?= "214MiB"
CACHE_VOLUME_SIZE ?= "15MiB"
SYSTEMRW_VOLUME_SIZE ?= "6MiB"
PERSIST_VOLUME_SIZE ?= "6MiB"

# Sizes for EXT4 (in bytes)
SYSTEM_SIZE_EXT4  ?= "${@bb.utils.contains('IMAGE_FEATURES', 'gluebi', '224395264', '273678336', d)}"
USERDATA_SIZE_EXT4 ?= "251658240"
CACHE_IMAGE_ROOTFS_SIZE ?= "26214400"

SDCARD_DEVICE = ""

# Formats of root filesystem images
IMAGE_FSTYPES += "ubi ext4"

MACHINE_SUPPORTS_PDMAPPER = "False"
MACHINE_SUPPORTS_INIT_RAMDISK = "False"
MACHINE_SUPPORTS_ANDROID_PROPERTIES = "False"
MACHINE_SUPPORTS_DIAG_OVER_PCIE = "True"
MACHINE_FSCONFIG_CONF = "sdxlemur-fsconfig.conf"

VERITY_IMAGES = "system.img ${@bb.utils.contains('IMAGE_FEATURES', 'gluebi', 'system-gluebi.ext4', '', d)}"

USBCOMPOSITION = "90DB"

# File indicating firmware residing places on device.
MACHINE_FILESMAP_CONF = "sdxlemur-filesmap"
MACHINE_FILESMAP_CONF_EMMC = "sdxlemur-emmc-filesmap"

# On msm-5.4 or above ufs driver supports BSG Device.
UFS_BSG_DEV_USAGE = "True"
```

## conf/machine/sxr2130-mtp.conf
```bitbake
#@TYPE: Machine
#@NAME: SXR2130 MTP
#@DESCRIPTION: Machine configuration for Kona based SXR2130 MTP

require conf/machine/include/sxr2130.inc

MACHINE_SUPPORTS_DTBO = "True"
DTBO_DTB_NAMES   = " \
    vendor/qcom/kona.dtb \
    vendor/qcom/kona-v2.dtb \
    vendor/qcom/kona-v2.1.dtb \
"

NON_DTBO_DTB_NAMES = " \
    vendor/qcom/kona-cdp.dtb \
    vendor/qcom/kona-cdp-lcd.dtb \
    vendor/qcom/kona-hdk.dtb \
    vendor/qcom/kona-mtp.dtb \
    vendor/qcom/kona-mtp-sa.dtb \
    vendor/qcom/kona-mtp-ws.dtb \
    vendor/qcom/kona-qrd.dtb \
    vendor/qcom/kona-rumi.dtb \
    vendor/qcom/kona-v2.1-cdp.dtb \
    vendor/qcom/kona-v2.1-hdk.dtb \
    vendor/qcom/kona-v2.1-iot-rb5.dtb \
    vendor/qcom/kona-v2.1-mtp.dtb \
    vendor/qcom/kona-v2.1-mtp-sa.dtb \
    vendor/qcom/kona-v2.1-mtp-ws.dtb \
    vendor/qcom/kona-v2.1-qrd.dtb \
    vendor/qcom/kona-v2.1-xrfusion.dtb \
    vendor/qcom/kona-v2.1-xrfusion-ult.dtb \
    vendor/qcom/kona-v2.1-arglass.dtb \
    vendor/qcom/kona-v2-cdp.dtb \
    vendor/qcom/kona-v2-mtp.dtb \
    vendor/qcom/kona-v2-mtp-sa.dtb \
    vendor/qcom/kona-v2-mtp-ws.dtb \
    vendor/qcom/kona-v2-qrd.dtb \
    vendor/qcom/kona-v2-rumi.dtb \
    vendor/qcom/kona-v2-xrfusion.dtb \
    vendor/qcom/kona-v2-xrfusion-ult.dtb \
    vendor/qcom/kona-v2-arglass.dtb \
    vendor/qcom/kona-xr.dtb \
    vendor/qcom/kona-xrfusion.dtb \
    vendor/qcom/kona-xrfusion-ult.dtb \
    vendor/qcom/kona-arglass.dtb \
"
KERNEL_DTB_NAMES = "${@bb.utils.contains('MACHINE_SUPPORTS_DTBO', 'True', "${DTBO_DTB_NAMES}", "${NON_DTBO_DTB_NAMES}", d)}"
KERNEL_IMAGETYPE   = "Image.gz"

KERNEL_BASE        = "0x80000000"
KERNEL_TAGS_OFFSET = "0x81900000"

KERNEL_CONFIG     ?= "vendor/kona-perf_defconfig"
KERNEL_CONFIG_qti-distro-debug ?= "vendor/kona_defconfig"

CONSOLE_PARAM     ?= ""
CONSOLE_PARAM_qti-distro-debug ?= "console=ttyMSM0,115200,n8"

KERNEL_CMD_PARAMS  = "noinitrd ${CONSOLE_PARAM} earlycon=msm_geni_serial,0xa90000 androidboot.hardware=qcom androidboot.console=ttyMSM0 androidboot.memcg=1 lpm_levels.sleep_disabled=1 video=vfb:640x400,bpp=32,memsize=3072000 msm_rtb.filter=0x237 service_locator.enable=1 androidboot.usbcontroller=a600000.dwc3 swiotlb=2048 loop.max_part=7 cgroup.memory=nokmem,nosocket reboot=panic_warm net.ifnames=0"

SERIAL_CONSOLE    ?= ""
SERIAL_CONSOLE_qti-distro-debug ?= "115200 ttyMSM0"

# bootloader configuration
EXTRA_IMAGEDEPENDS += "edk2"

# Conf with partition entries required for machine.
MACHINE_PARTITION_CONF = "qrb5165-rb5-partition.conf"

# filesystem configurations to be applied on image.
MACHINE_FSCONFIG_CONF = "qrb5165-fsconfig.conf"

# File indicating firmware residing places on device.
MACHINE_FILESMAP_CONF = "kona-filesmap"

# Sizes for EXT4 (in bytes)
SYSTEM_SIZE_EXT4 = "629145600"
USERDATA_SIZE_EXT4 = "30064771072"

# MACHINE_FEATURES ##
# ubwc:                 Machine supports UBWC hardware
# qti-wifi:             Machine supports QTI WiFi solution
# qti-audio:            Machine supports QTI audio solution
# qti-adsp:             Machine supports QTI adsp solution
# qti-video:            Machine supports QTI video solution
# qti-cvp:              Machine supports QTI cvp solution
# qti-ab-boot:          Machine support a/b boot
# opencl:               Machine supports OpenCL driver
# drm :                 Machine supports DRM display drivers
# dm-verity-bootloader: Machine supports bootloader-based dm-verity implementation
# qti-security:        Support QTI security solution
# qti-npu:             Support QTI npu solution

MACHINE_FEATURES += "qti-adsp qti-audio qti-bluetooth qti-ab-boot qti-cdsp qti-wifi qti-video \
                     ubwc opencl drm qti-security qti-cvp qti-camera \
                     dm-verity-bootloader qti-slpi qti-sensors qti-npu"
```

## conf/machine/sxrneo.conf
```bitbake
#@TYPE: Machine
#@NAME: Neo
#@DESCRIPTION: Machine configuration for Neo

require conf/machine/include/neo.inc

KERNEL_IMAGETYPE   = "Image"

MACHINE_SUPPORTS_DTBO = "True"
KERNEL_DTB_NAMES   = " \
    neo.dtb \
"
MACHINE_USES_KERNEL_PREBUILTS = "True"
KERNEL_PREBUILT_PATH ?= "${WORKSPACE}/kernel-5.10/out/neo_le-defconfig"
KERNEL_PREBUILT_PATH_qti-distro-debug ?= "${WORKSPACE}/kernel-5.10/out/neo_le-debug_defconfig"

KERNEL_PREBUILT_DISTDIR = "${KERNEL_PREBUILT_PATH}/dist"

KERNEL_BASE        = "0x80000000"

KERNEL_CONFIG     ?= "build.config.neo_le"
KERNEL_CONFIG_qti-distro-debug ?= "build.config.neo_le"

CONSOLE_PARAM     ?= ""

KERNEL_CMD_PARAMS ?= ""

SERIAL_CONSOLES    ?= ""
SERIAL_CONSOLES_qti-distro-debug = "115200;ttyMSM0"

# bootloader configuration
EXTRA_IMAGEDEPENDS += "edk2"

# Conf with partition entries required for machine.
#MACHINE_PARTITION_CONF = "qrb5165-rb5-partition.conf"

# filesystem configurations to be applied on image.
MACHINE_FSCONFIG_CONF = "neo-fsconfig.conf"

# init ramdisk image to be used for first stage boot.
INITRAMFS_IMAGE = "qti-ramdisk-image"
INITRAMFS_FSTYPES = "cpio.gz"

# File indicating firmware residing places on device.
MACHINE_FILESMAP_CONF = "neo-filesmap"

# Enable qti-ab-boot feature without OTA package
GENERATE_AB_OTA_PACKAGE = "0"

# MACHINE_FEATURES ##
# emmc-boot:            Machine supports eMMC device
# drm :                 Machine supports DRM display drivers
# qti-adsp:             Machine supports QTI adsp solution
# qti-cdsp:             Machine supports QTI cdsp solution
# qti-eva:              Machine supports QTI eva solution
# qti-camera:           Machine supports QTI camera solution
# qti-ab-boot:          Machine support a/b boot

MACHINE_FEATURES += "drm emmc-boot qti-adsp qti-cdsp qti-eva qti-camera qti-ab-boot dm-verity-none"
```

## conf/machine/trustedvm.conf
```bitbake
#@TYPE: Machine
#@NAME: TRUSTEDVM
#@DESCRIPTION: Machine configuration for QTI MTP with TRUSTEDVM

BASEMACHINE ?= "trustedvm"
require conf/machine/include/basemachine.inc

DEFAULTTUNE ?= "aarch64"
include conf/machine/include/arm/arch-armv8a.inc

PREFERRED_PROVIDER_virtual/kernel = "linux-dummy"
PREFERRED_VERSION_linux-msm ?= "5.15"
PREFERRED_VERSION_linux-msm-headers ?= "5.15"
PREFERRED_VERSION_coreutils ?= "6.9"

LLVM_VERSION = "8.0"

PAGE_SIZE ?= '4096'

EXTRA_IMAGECMD ?= "-N 2048"

KERNEL_IMAGETYPE = "Image"
KERNEL_CMD_PARAMS = ""
KERNEL_VARIANT = ""
KERNEL_VARIANT_qti-distro-base-debug = "debug_"
SERIAL_CONSOLE = "115200 hvc0"

MACHINE_USES_KERNEL_PREBUILTS = "True"
KERNEL_PREBUILT_PATH ?= "${WORKSPACE}/kernel-5.15/out/msm-kernel-${VM_TARGET}_tuivm-${KERNEL_VARIANT}defconfig/dist"

# filesystem configurations to be applied on image.
MACHINE_FSCONFIG_CONF = "trustedvm-fsconfig.conf"
MACHINE_SUPPORTS_USB = "False"
MACHINE_SUPPORTS_ANDROID_PROPERTIES = "False"
MACHINE_SUPPORTS_DISPLAY = "True"
MACHINE_SUPPORTS_SECUREMSM = "True"
MACHINE_SUPPORTS_TOUCH = "True"
MACHINE_SUPPORTS_OEMVM = "True"
MACHINE_MNT_POINTS = ""
ENABLE_ADB = "False"
# Formats of root filesystem images.
IMAGE_FSTYPES += "ext4"
IMAGE_INIT_MANAGER = "systemd"

SYSTEMIMAGE_TARGET = "system.img"
VMUSERDATAIMAGE_TARGET = "vm-userdata.img"
VMIMAGE_TARGET = "vm-bootsys.img"
VMPERSIST_TARGET = "vm-persist.img"
DTB_TARGET = "vm.dtb"
KERNEL_OFFSET_TRUSTEDVM = "0x0"
DTB_OFFSET_TRUSTEDVM = "0x2000000"
RAMDISK_OFFSET_TRUSTEDVM = "0x2100000"

KERNEL_OFFSET_OEMVM = "0x0"
DTB_OFFSET_OEMVM = "0x2000000"
RAMDISK_OFFSET_OEMVM = "0x2100000"

# Ramdisk size is 8 MB
RAMDISK_SIZE = "10388608"

SYSTEM_SIZE_EXT4 ?= "220000000"
USERDATA_SIZE_EXT4 ?= "25000000"
PERSIST_IMAGE_ROOTFS_SIZE = "119000000"
PERSIST_SIZE_EXT4 = "119000000"
VM_PERSIST_SIZE_EXT4 ?= "125829120"
VM_SIZE_EXT4 ?= "550000000"

MACHINE_FEATURES_append = " dm-verity-initramfs qti-vm qti-vm-persist qti-multivm qti-vm-file-transfer qti-vm-demuratn"

PREFERRED_PROVIDER_virtual/base-utils = "toybox"
VIRTUAL-RUNTIME_base-utils = "toybox"
VIRTUAL-RUNTIME_base-utils-hwclock = ""
VIRTUAL-RUNTIME_base-utils-syslog = ""
VIRTUAL-RUNTIME_login_manager = ""
INIT_MANAGER = "systemd"
TOYBOX_RAMDISK = "True"

# On msm-5.4 or above ufs driver supports BSG Device.
UFS_BSG_DEV_USAGE = "True"
```

## meta-qti-customizations/conf/layer.conf
```bitbake
BBPATH .= ":${LAYERDIR}"

BBFILE_COLLECTIONS                 += "qti-customizations"
BBFILE_PATTERN_qti-customizations  := "^${LAYERDIR}/"
BBFILE_PRIORITY_qti-customizations  = "20"

LAYERSERIES_COMPAT_qti-customizations = "dunfell"

# Add layer-specific bb files & bbappends only when that layer is included
BBFILES_DYNAMIC += "${@' '.join('%s:${LAYERDIR}/%s/recipes*/*/*.bb' % (layer, layer) \
              for layer in BBFILE_COLLECTIONS.split())}"
BBFILES_DYNAMIC += "${@' '.join('%s:${LAYERDIR}/%s/recipes*/*/*.bbappend' % (layer, layer) \
              for layer in BBFILE_COLLECTIONS.split())}"
```
