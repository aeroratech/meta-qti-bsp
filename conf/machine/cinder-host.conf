## conf/machine/cinder-host.conf
```bitbake
#@TYPE: Machine
#@NAME: CINDER
#@DESCRIPTION: Machine configuration for QTI MTP with CINDER
BASEMACHINE ?= "cinder-host"
#require conf/machine/include/basemachine.inc
require conf/machine/include/x86/arch-x86.inc

MACHINE_FEATURES += ""

IMAGE_FSTYPES = ""

PAGE_SIZE ?= '0'

MACHINE_MNT_POINTS = ""

# Sizes for EXT4 (in bytes)
SYSTEM_SIZE_EXT4  ?= "0"
USERDATA_SIZE_EXT4 ?= "0"
PERSIST_IMAGE_ROOTFS_SIZE ?= "0"
CACHE_IMAGE_ROOTFS_SIZE ?= "0"
SYSTEMRW_IMAGE_ROOTFS_SIZE ?= "0"
PREFERRED_PROVIDER_virtual/kernel = "linux-dummy"
PREFERRED_VERSION_linux-msm ?="5.15"
```

## conf/machine/cinder.conf
```bitbake
#@TYPE: Machine
#@NAME: CINDER
#@DESCRIPTION: Machine configuration for QTI MTP with CINDER
BASEMACHINE ?= "cinder"
require conf/machine/include/basemachine.inc

DEFAULTTUNE ?= "aarch64"
include conf/machine/include/arm/arch-armv8a.inc

PREFERRED_PROVIDER_virtual/kernel = "linux-msm"
PREFERRED_PROVIDER_virtual/mkbootimg-native = "mkbootimg-gki-native"
PREFERRED_PROVIDER_virtual/dtc-native = "dtc-android-build-native"
PREFERRED_VERSION_linux-msm ?= "5.15"
PREFERRED_VERSION_linux-msm-headers ?= "5.15"
PREFERRED_VERSION_kernel-toolchain ?= "5.15"
PREFERRED_VERSION_dtc-android-build ?= "5.15"
PREFERRED_VERSION_mkbootimg-gki-native ?= "5.15"

SERIAL_CONSOLE = "115200;ttyMSM0"
SERIAL_CONSOLES ?= "115200;ttyGS1"
KERNEL_IMAGETYPE = "Image"
KERNEL_BASE = "0x80000000"
KERNEL_TAGS_OFFSET = "0x80000000"
KERNEL_CONFIG ?= "vendor/cinder_defconfig"
KERNEL_DTB_NAMES = "dtbs/dtb.img"
KERNEL_CONFIG_qti-distro-debug ?= "vendor/cinder-debug_defconfig"
KERNEL_CMD_PARAMS = "console=ttyGS1,115200n8 console=ttyMSM0,115200,n8 earlycon=qcom_geni,0x0099C000 msm_geni_serial.con_enabled=1 loglevel=4 rootfstype=ext4 rootwait"
#KERNEL_CMD_PARAMS = "ro rootwait console=ttyMSM0,115200,n8 androidboot.hardware=qcom msm_rtb.filter=0x237 androidboot.console=ttyMSM0 lpm_levels.sleep_disabled=1 firmware_class.path=/lib/firmware/updates service_locator.enable=1 net.ifnames=0 atlantic_fwd.rx_ring_size=512 atlantic_fwd.rx_linear=1 pcie_ports=compat"
KERNEL_VARIANT = ""
KERNEL_VARIANT_qti-distro-base-debug = "debug_"
KERNEL_VARIANT_qti-distro-base-perf = "perf_"
KERNEL_VARIANT_qti-distro-base-user = "perf_"
#KERNEL_DYNAMIC_DEFCONFIG = "True"

MACHINE_USES_KERNEL_PREBUILTS = "True"
KERNEL_PREBUILT_PATH ?= "${WORKSPACE}/kernel-5.15/out/msm-kernel-cinder-${KERNEL_VARIANT}defconfig/dist"
KERNEL_OUT_PATH = "${WORKSPACE}/kernel-5.15/out/msm-kernel-cinder-${KERNEL_VARIANT}defconfig"
KERNEL_BUILD_CONFIG = "msm-kernel/build.config.msm.cinder"

PAGE_SIZE ?= '4096'

RAMDISK = "${IMGDEPLOYDIR}/${PN}-initrd.gz"

#Abl would be enabled later
#EXTRA_IMAGEDEPENDS += "edk2"

# TODO: Temporary change to override BB_SIGNATURE_HANDLER set in local.conf.
# Other machines are already supporting OEEquivHash as hashing signature.
# Fix build issues observed in this machine and remove this override.
BB_SIGNATURE_HANDLER = "OEBasicHash"

#QSEEComCompat and QSEECom are mutually exlusive and QSEEComCompat depends on  smcinvoke
#lv-build builds the required listernes , le_qseecom enables qseecomd
MACHINE_FEATURES += "qti-csm qti-mplane qti-mace dm-verity-none qti-remoteproc file-based-encryption lv-build le_qseecom qseecompat smcinvoke minkipc qti-tzlog qwesd"


##############################################################

# SElinux enablement in enforcing mode

#############################################################

DEFAULT_ENFORCING = "enforcing"

MACHINE_MNT_POINTS = " \
    /firmware \
    /persist \
    /data \
    /cache \
    /systemrw \
"
USERDATA_DIR = "${@bb.utils.contains('MACHINE_MNT_POINTS', '/overlay', 'overlay', 'data', d)}"

# Sizes for EXT4 (in bytes)
SYSTEM_SIZE_EXT4  ?= "268435456"
USERDATA_SIZE_EXT4 ?= "251658240"

# Formats of root filesystem images
IMAGE_FSTYPES += "ext4"

MACHINE_SUPPORTS_ADB_OVER_PCIE = "True"
MACHINE_SUPPORTS_DIAG_OVER_PCIE = "True"
MACHINE_SUPPORTS_PDMAPPER = "False"
MACHINE_SUPPORTS_INIT_RAMDISK = "False"
MACHINE_SUPPORTS_FLASHLESS_MEMORY = "True"
TOYBOX_RAMDISK = "True"
MACHINE_SUPPORTS_ANDROID_PROPERTIES = "False"
MACHINE_FSCONFIG_CONF = "cinder-fsconfig.conf"

USBCOMPOSITION = "9060"

# Conf with partition entries required for machine.
MACHINE_PARTITION_CONF = "cinder-partition.conf"

# File indicating firmware residing places on device.
MACHINE_FILESMAP_CONF = "cinder-filesmap"

# On msm-5.4 or above ufs driver supports BSG Device.
UFS_BSG_DEV_USAGE = "True"

# Fixes for boot image dtb appending
BOOT_HEADER_VERSION = "2"

QIMGEXTENSION += "qdlkm"

# qti-vble:   Support QTI Verified boot for LE
DISTRO_FEATURES += "qti-vble"
```

## conf/machine/genericarmv8.conf
```bitbake
#@TYPE: Machine
#@NAME: GENERICARMv8
#@DESCRIPTION: Machine configuration for QTI MTP with GENERICARMv8

require conf/machine/include/genericarmv8.inc

KERNEL_IMAGETYPE = "Image"
KERNEL_BASE = "0xA0000000"
KERNEL_TAGS_OFFSET = "0xA3200000"

KERNEL_CMD_PARAMS = "console=hvc0 root=/dev/vblock0 rootfstype=ext4 rootwait"
KERNEL_VARIANT = ""
KERNEL_VARIANT_qti-distro-base-debug = "debug_"
SERIAL_CONSOLE = "115200 hvc0"

MACHINE_USES_KERNEL_PREBUILTS = "True"
KERNEL_PREBUILT_PATH ?= "${WORKSPACE}/kernel-5.10/out/msm-waipio-waipio_tuivm-defconfig"
KERNEL_PREBUILT_PATH_qti-distro-debug ?= "${WORKSPACE}/kernel-5.10/out/msm-waipio-waipio_tuivm-debug_defconfig"
KERNEL_PREBUILT_DISTDIR = "${KERNEL_PREBUILT_PATH}/dist"

KERNEL_OUT_PATH = "${WORKSPACE}/kernel-5.10/out/msm-waipio-waipio_tuivm-${KERNEL_VARIANT}defconfig/"
KERNEL_BUILD_CONFIG = "msm-kernel/build.config.msm.waipio.tuivm"

# filesystem configurations to be applied on image.
MACHINE_FSCONFIG_CONF = "genericarmv8-fsconfig.conf"
MACHINE_SUPPORTS_USB = "False"
MACHINE_SUPPORTS_ANDROID_PROPERTIES = "False"
MACHINE_SUPPORTS_TOUCH ="False"
MACHINE_MNT_POINTS = ""
ENABLE_ADB = "False"
# Formats of root filesystem images.
IMAGE_FSTYPES += "ext4"
IMAGE_INIT_MANAGER = "systemd"

SYSTEMIMAGE_TARGET = "system.img"
VMUSERDATAIMAGE_TARGET = "vm-userdata.img"
VMIMAGE_TARGET = "vm-bootsys.img"
DTB_TARGET = "vm.dtb"
KERNEL_OFFSET_TRUSTEDVM = "0XE0B00000"
DTB_OFFSET_TRUSTEDVM = "0xE2B00000"
RAMDISK_OFFSET_TRUSTEDVM = "0xE2E00000"
# Ramdisk size is 10 MB
RAMDISK_SIZE = "10485760"

MACHINE_FEATURES_append = " emmc-boot dm-verity-initramfs qti-vm"
```

## conf/machine/include/apq8009.inc
```bitbake
BASEMACHINE ?= "apq8009"
require conf/machine/include/basemachine.inc

SOC_FAMILY ?= "msm8909"
include conf/machine/include/soc-family.inc

DEFAULTTUNE ?= "armv7ahf-neon"

include conf/machine/include/tune-cortexa7.inc

PREFERRED_PROVIDER_virtual/kernel = "linux-msm"
PREFERRED_VERSION_linux-msm ?= "4.9"

SERIAL_CONSOLE ?= "115200 ttyHSL0"

PAGE_SIZE ?= '4096'

# Max supported inodes
EXTRA_IMAGECMD ?= "-N 2048"

MACHINE_MNT_POINTS = "/firmware \
                      /overlay \
                     "

# Sizes for EXT4 (in bytes)
# Keep it same as defined in *.partition.conf, for the dm verity to work
SYSTEM_SIZE_EXT4 ?= "536870912"
OVERLAY_SIZE_EXT4 ?= "2100000000"

# Formats of root filesystem images.
IMAGE_FSTYPES += "ext4"

# Disable some default features supported from upstream
MACHINE_FEATURES_BACKFILL_CONSIDERED += "qemu-usermode rtc"

# This flag is valid only when "dm-verity" feature is enabled.
# Pick dm-android-verity kernel driver (defined by CONFIG_DM_ANDROID_VERITY=y)
# that is supported on 4.9 and earlier kernel versions.
# Otherwise, dm-verity kernel driver is picked, by default.
LEGACY_DM_ANDROID_VERITY_DRIVER = "1"

# Use legacy ion implementation if msm kernel version is 4.9 or below
LEGACY_ION_USAGE = "True"
```

## conf/machine/include/genericarmv8.inc
```bitbake
BASEMACHINE ?= "genericarmv8"
require conf/machine/include/basemachine.inc

DEFAULTTUNE ?= "aarch64"
include conf/machine/include/arm/arch-armv8a.inc

PREFERRED_PROVIDER_virtual/kernel = "linux-dummy"
PREFERRED_VERSION_linux-msm ?= "5.10"
PREFERRED_VERSION_linux-msm-headers ?= "5.10"
PREFERRED_VERSION_kernel-toolchain ?= "5.10"
PREFERRED_VERSION_dtc-android-build ?= "5.10"

LLVM_VERSION = "8.0"

PAGE_SIZE ?= '4096'

EXTRA_IMAGECMD ?= "-N 2048"

SYSTEM_SIZE_EXT4 ?= "225000000"
USERDATA_SIZE_EXT4 ?= "25000000"
VM_SIZE_EXT4 ?= "270000000"

# On msm-5.4 or above ufs driver supports BSG Device.
UFS_BSG_DEV_USAGE = "True"
```

## conf/machine/include/kona.inc
```bitbake
SOC_FAMILY ?= "kona"
include conf/machine/include/soc-family.inc

require conf/machine/include/arm/arch-armv8a.inc

PREFERRED_PROVIDER_virtual/kernel = "linux-msm"
PREFERRED_VERSION_linux-msm ?= "4.19"
```

## conf/machine/include/neo.inc
```bitbake
BASEMACHINE ?= "neo"
require conf/machine/include/basemachine.inc

include conf/machine/include/waipio.inc

PAGE_SIZE ?= '4096'

MACHINE_MNT_POINTS = "/firmware \
                      /dsp \
                      /bt_firmware \
                      /overlay \
                      /persist \
                     "

# Sizes for EXT4 partitions
SYSTEM_SIZE_EXT4 ?= "800MiB"
USERDATA_SIZE_EXT4 ?= "16GiB"

# Formats of root filesystem images.
IMAGE_FSTYPES += "ext4"

# Disable some default features supported from upstream
MACHINE_FEATURES_BACKFILL_CONSIDERED += "qemu-usermode rtc"
```

## conf/machine/include/qcs40x.inc
```bitbake
BASEMACHINE ?= "qcs40x"
require conf/machine/include/basemachine.inc

SOC_FAMILY ?= "qcs405"
include conf/machine/include/soc-family.inc

DEFAULTTUNE ?= "aarch64"
include conf/machine/include/arm/arch-armv8.inc

PREFERRED_PROVIDER_virtual/kernel = "linux-msm"
PREFERRED_VERSION_linux-msm ?= "4.14"

LLVM_VERSION = "6.0"

PAGE_SIZE ?= '4096'

EXTRA_IMAGECMD ?= "-N 2048"

MACHINE_MNT_POINTS = "/dsp \
                      /firmware \
                      /overlay \
                     "

# Sizes for EXT4 (in bytes)
SYSTEM_SIZE_EXT4 ?= "681574400"
OVERLAY_SIZE_EXT4 ?= "33554432"

# Formats of root filesystem images
IMAGE_FSTYPES += "ext4"
```

## conf/machine/include/qcs610.inc
```bitbake
BASEMACHINE ?= "sdmsteppe"
require conf/machine/include/basemachine.inc

SOC_FAMILY ?= "qcs610"
include conf/machine/include/soc-family.inc

include conf/machine/include/arm/arch-armv8a.inc

PREFERRED_PROVIDER_virtual/kernel = "linux-msm"
PREFERRED_VERSION_linux-msm ?= "5.4"
PREFERRED_VERSION_linux-msm-headers ?= "5.4"

PAGE_SIZE ?= '4096'

# Max supported inodes
EXTRA_IMAGECMD ?= "-N 2048"

MACHINE_MNT_POINTS = "/firmware \
                      /overlay \
                      /dsp \
                      /bt_firmware \
                      /persist \
                     "

# Sizes for EXT4 (in bytes)
SYSTEM_SIZE_EXT4  ?= "1050214400"
USERDATA_SIZE_EXT4 ?= "8589934592"

# Formats of root filesystem images.
IMAGE_FSTYPES += "ext4"

# Disable some default features supported from upstream
MACHINE_FEATURES_BACKFILL_CONSIDERED += "qemu-usermode rtc"
```

## conf/machine/include/qrb5165.inc
```bitbake
BASEMACHINE ?= "qrb5165"
require conf/machine/include/basemachine.inc

SOC_FAMILY ?= "kona"
include conf/machine/include/soc-family.inc

require conf/machine/include/arm/arch-armv8a.inc

PREFERRED_PROVIDER_virtual/kernel = "linux-msm"
PREFERRED_VERSION_linux-msm ?= "4.19"

PAGE_SIZE ?= '4096'

# Max supported inodes
EXTRA_IMAGECMD ?= "-N 2048"

MACHINE_MNT_POINTS = "/firmware \
                      /dsp \
                      /bt_firmware \
                     "

# Sizes for EXT4 (in bytes)
SYSTEM_SIZE_EXT4 ?= "524288000"
USERDATA_SIZE_EXT4 ?= "33554432"

# Formats of root filesystem images.
IMAGE_FSTYPES += "ext4"

# Disable some default features supported from upstream
MACHINE_FEATURES_BACKFILL_CONSIDERED += "qemu-usermode rtc"
```

## conf/machine/include/sa2150p-base.inc
```bitbake
require conf/machine/include/qcs40x.inc

# Build architecture configuration
DEFAULTTUNE = "aarch64"

PREFERRED_PROVIDER_virtual/kernel = "linux-msm"
PREFERRED_VERSION_linux-msm = "5.4"
PREFERRED_VERSION_linux-msm-headers = "5.4"

KERNEL_IMAGETYPE = "Image.gz"
KERNEL_BASE = "0x80000000"
KERNEL_TAGS_OFFSET = "0x1e00000"
KERNEL_DYNAMIC_DEFCONFIG = "True"

SERIAL_CONSOLES = "115200;ttyMSM0"

# Bootloader configuration
EXTRA_IMAGEDEPENDS += "edk2"

# Fixed load address to support multiple DDR configuration
ABL_LOAD_ADDRESS = "0X8B500000"

# MACHINE_FEATURES ##
# qti-adsp:               Machine supports QTI adsp solution
# qti-cdsp:               Machine supports QTI cdsp solution
# qti-ab-boot:            Machine supports a/b boot
# qti-security:           Machine supports QTI security solution
# dm-verity-bootloader:   Machine supports bootloader-based dm-verity implementation
# qti-wifi:               Machine supports QTI WiFi solution
# qti-audio:              Machine supports QTI audio solution
# qti-bluetooth:          Machine supports QTI bluetooth solution
# qti-sensors:            Machine supports sensors qti solution
# qti-location:           Machine supports Location solution
# qti-data-modem:         Machine supports QTI data modem solution
# qti-external-ap         Machine supports QTI external AP solution
# qti-cv2x:               Machine supports QTI Cellular V2X solution

MACHINE_FEATURES += "qti-security qti-location qti-external-ap"

MACHINE_SUPPORTS_PDMAPPER = "False"
MACHINE_SUPPORTS_INIT_RAMDISK = "False"

USBCOMPOSITION = "901D"

PREFERRED_VERSION_protobuf = "3.11.4"
PREFERRED_VERSION_protobuf-native = "3.11.4"
PREFERRED_VERSION_iproute2 = "5.5.0"

# On msm-5.4 or above ufs driver supports BSG Device.
UFS_BSG_DEV_USAGE = "True"
```
