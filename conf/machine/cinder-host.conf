## conf/machine/include/sa410m.inc
```bitbake
BASEMACHINE ?= "sa410m"
require conf/machine/include/basemachine.inc

SOC_FAMILY ?= "bengal"
include conf/machine/include/soc-family.inc

DEFAULTTUNE ?= "aarch64"
include conf/machine/include/arm/arch-armv8a.inc

PREFERRED_PROVIDER_virtual/kernel = "linux-msm"
PREFERRED_PROVIDER_virtual/mkbootimg-native = "mkbootimg-gki-native"
PREFERRED_PROVIDER_virtual/dtc-native = "dtc-android-build-native"
PREFERRED_PROVIDER_virtual/mkdtimg-native = "mkdtimg-gki-native"
PREFERRED_VERSION_linux-msm = "5.15"
PREFERRED_VERSION_linux-msm-headers = "5.15"
PREFERRED_VERSION_kernel-toolchain = "5.15"
PREFERRED_VERSION_dtc-android-build = "5.15"
PREFERRED_VERSION_mkbootimg-gki-native = "5.15"
PREFERRED_VERSION_dtc-android-build-native = "5.15"
PREFERRED_VERSION_mkdtimg-gki-native = "5.15"
SERIAL_CONSOLES = "115200;ttyMSM0"
KERNEL_IMAGETYPE = "Image"
KERNEL_BASE = "0x40000000"
KERNEL_TAGS_OFFSET = "0x1e00000"
KERNEL_DYNAMIC_DEFCONFIG = "True"
KERNEL_CONFIG ?= "vendor/sa410m_auto_defconfig"
KERNEL_CONFIG_qti-distro-debug ?= "vendor/sa410m_auto-debug_defconfig"
KERNEL_CMD_PARAMS = "noinitrd ro rootwait console=ttyMSM0,115200,n8 no_console_suspend=1 androidboot.hardware=qcom androidboot.console=ttyMSM0 lpm_levels.sleep_disabled=1 service_locator.enable=1 firmware_class.path=/lib/firmware/updates msm_rtb.filter=0x237 earlycon=qcom_geni,0x4a90000 systemd.setenv="SLOT_SUFFIX"="_a""

KERNEL_VARIANT = ""
KERNEL_VARIANT_qti-distro-debug = "debug_"
KERNEL_VARIANT_qti-distro-perf = "perf_"

MACHINE_SUPPORTS_DTBO = "True"
KERNEL_DTB_NAMES      = "dtbs/dtb.img"

MACHINE_USES_KERNEL_PREBUILTS = "True"
KERNEL_PREBUILT_PATH ?= "${WORKSPACE}/kernel-5.15/out/msm-kernel-sa410m_auto-${KERNEL_VARIANT}defconfig/dist"
KERNEL_OUT_PATH ?= "${WORKSPACE}/kernel-5.15/out/msm-kernel-sa410m_auto-${KERNEL_VARIANT}defconfig"
KERNEL_BUILD_CONFIG ?= "msm-kernel/build.config.msm.sa410m_auto"

# Bootloader configuration
#EXTRA_IMAGEDEPENDS += "edk2"

# MACHINE_FEATURES ##
# qti-adsp:               Machine supports QTI adsp solution
# qti-cdsp:               Machine supports QTI cdsp solution
# qti-ab-boot:            Machine supports a/b boot
# qti-security:           Machine supports QTI security solution
# qti-wifi:               Machine supports QTI WiFi solution
# qti-audio:              Machine supports QTI audio solution
# qti-bluetooth:          Machine supports QTI bluetooth solution
# qti-sensors:            Machine supports sensors qti solution
# qti-location:           Machine supports Location solution
# qti-data-modem:         Machine supports QTI data modem solution

MACHINE_FEATURES += "qti-ab-boot qti-sdx nossd_listener dm-verity-none qti-remoteproc qti-sensors qti-qseecom qti-tzlog qti-security"

MACHINE_MNT_POINTS = " \
    /dsp \
    /firmware \
    /systemrw \
    /persist \
    /data \
    /cache \
"

PAGE_SIZE ?= '4096'
EXTRA_IMAGECMD ?= "-N 2048"

MACHINE_SUPPORTS_INIT_RAMDISK = "False"
MACHINE_SUPPORTS_ANDROID_PROPERTIES = "False"
MACHINE_SUPPORTS_USB_AUTOSUSPEND = "False"

USBCOMPOSITION = "90DB"

# On msm-5.4 or above ufs driver supports BSG Device.
UFS_BSG_DEV_USAGE = "True"

PREFERRED_VERSION_protobuf = "3.11.4"
PREFERRED_VERSION_protobuf-native = "3.11.4"
PREFERRED_VERSION_iproute2 = "5.5.0"

# Fixes for boot image dtb appending
BOOT_HEADER_VERSION = "2"
```

## conf/machine/include/sa525m.inc
```bitbake
BASEMACHINE ?= "sa525m"
require conf/machine/include/basemachine.inc

DEFAULTTUNE ?= "aarch64"
include conf/machine/include/arm/arch-armv8a.inc

PREFERRED_PROVIDER_virtual/kernel = "linux-msm"
PREFERRED_PROVIDER_virtual/mkbootimg-native = "mkbootimg-gki-native"
PREFERRED_PROVIDER_virtual/dtc-native = "dtc-android-build-native"
PREFERRED_PROVIDER_virtual/mkdtimg-native = "mkdtimg-gki-native"
PREFERRED_VERSION_linux-msm = "5.15"
PREFERRED_VERSION_linux-msm-headers = "5.15"
PREFERRED_VERSION_kernel-toolchain = "5.15"
PREFERRED_VERSION_dtc-android-build = "5.15"
PREFERRED_VERSION_mkbootimg-gki-native = "5.15"
PREFERRED_VERSION_dtc-android-build-native = "5.15"
PREFERRED_VERSION_mkdtimg-gki-native = "5.15"
PREFERRED_VERSION_qcrosvm = "1.1"
PREFERRED_VERSION:securemsmdlkm ?= "1.0"
SERIAL_CONSOLES = "115200;ttyMSM0"
KERNEL_IMAGETYPE = "Image"
KERNEL_BASE = "0xa8000000"
KERNEL_TAGS_OFFSET = "0x1e00000"
KERNEL_CONFIG ?= "vendor/sa525_defconfig"
KERNEL_CONFIG_qti-distro-debug ?= "vendor/sa525-debug_defconfig"
CONSOLE_PARAM ?= "console=ttyMSM0,115200,n8 no_console_suspend=1"
CONSOLE_PARAM_qti-distro-perf ?= "console=ttyMSM0,115200,n8 no_console_suspend=1 loglevel=0 systemd.log_level=0 systemd.show_status=0"
KERNEL_CMD_PARAMS = "ro rootwait ${CONSOLE_PARAM} androidboot.console=ttyMSM0 lpm_levels.sleep_disabled=1 firmware_class.path=/lib/firmware/updates,/vm-bootsys/boot service_locator.enable=1 net.ifnames=0"
KERNEL_VARIANT ??= ""
KERNEL_VARIANT_qti-distro-debug ??= "debug_"
KERNEL_VARIANT_qti-distro-perf ??= "perf_"
KERNEL_DTB_NAMES = "dtbs/dtb.img"

MACHINE_USES_KERNEL_PREBUILTS = "True"
KERNEL_PREBUILT_PATH ?= "${WORKSPACE}/kernel-5.15/out/msm-kernel-sa525-${KERNEL_VARIANT}defconfig/dist"
KERNEL_OUT_PATH ?= "${WORKSPACE}/kernel-5.15/out/msm-kernel-sa525-${KERNEL_VARIANT}defconfig"
KERNEL_BUILD_CONFIG ?= "msm-kernel/build.config.msm.sa525"


# MACHINE_FEATURES ##
# qti-adsp:               Machine supports QTI adsp solution
# qti-cdsp:               Machine supports QTI cdsp solution
# qti-ab-boot:            Machine supports a/b boot
# qti-security:           Machine supports QTI security solution
# qti-wifi:               Machine supports QTI WiFi solution
# qti-audio:              Machine supports QTI audio solution
# qti-bluetooth:          Machine supports QTI bluetooth solution
# qti-sensors:            Machine supports sensors qti solution
# qti-location:           Machine supports Location solution
# qti-data-modem:         Machine supports QTI data modem solution
# qti-mvm:                Machine supports QTI MVM solution
# qseecompat:             Machine supports qseecom compat solution
# qti-tzlog:              Machine supports tz/qsee logs
# qti-smciqseecomd:       Machine supports smcinvoke based listeners
# android-binder:         Machine supports android binder
# dm-verity-initramfs-v4: Machine supports Initramfs and dm-verity working with AVB
# qti-nad-telaf:          Machine supports telematics application framework
# qti-nad-mrc             Machine supports mrcd feature

MACHINE_FEATURES += "qti-sdx dm-verity-initramfs-v4 qti-sensors qti-mvm qti-security qseecompat qti-tzlog qti-data-modem qti-location qti-audio qti-smciqseecomd qti-recovery qti-wwan-plus-cv2x qti-wlan qti-bluetooth qwesd android-binder qti-c2c qti-cv2x-compensator qti-dynamic-tsensreset qti-nad-telaf qti-nad-mrc qti-softsku"

CONFLICT_MACHINE_FEATURES += "qti-cv2x"

MACHINE_MNT_POINTS = " \
    /firmware \
    /systemrw \
    /persist \
    /data \
    /cache \
"

PAGE_SIZE ?= '4096'
EXTRA_IMAGECMD ?= "-N 2048"

MACHINE_SUPPORTS_DTBO = "True"
MACHINE_SUPPORTS_PDMAPPER = "False"
MACHINE_SUPPORTS_INIT_RAMDISK = "False"
TOYBOX_RAMDISK = "False"
MACHINE_SUPPORTS_ANDROID_PROPERTIES = "False"

USBCOMPOSITION = "90DB"

# On msm-5.4 or above ufs driver supports BSG Device.
UFS_BSG_DEV_USAGE = "True"

PREFERRED_VERSION_protobuf = "3.11.4"
PREFERRED_VERSION_protobuf-native = "3.11.4"

# Fixes for boot image dtb appending
BOOT_HEADER_VERSION = "2"
```

## conf/machine/include/scuba.inc
```bitbake
BASEMACHINE ?= "scuba"
require conf/machine/include/basemachine.inc

SOC_FAMILY ?= "bengal"
include conf/machine/include/soc-family.inc

require conf/machine/include/arm/arch-armv8a.inc

PREFERRED_PROVIDER_virtual/kernel = "linux-msm"
PREFERRED_VERSION_linux-msm ?= "5.4"
PREFERRED_VERSION_linux-msm-headers ?= "5.4"


MACHINE_MNT_POINTS = "/firmware \
                      /overlay \
                     "

# Sizes for EXT4 (in bytes)
SYSTEM_SIZE_EXT4 ?= "524288000"
USERDATA_SIZE_EXT4 ?= "33554432"

# Formats of root filesystem images.
IMAGE_FSTYPES += "ext4"

# Size for smallest contiguous block of physical memory
PAGE_SIZE ?= '4096'

#Disable some default features supported from upstream
MACHINE_FEATURES_BACKFILL_CONSIDERED += "qemu-usermode rtc"
```

## conf/machine/include/sxr2130.inc
```bitbake
BASEMACHINE ?= "sxr2130"
require conf/machine/include/basemachine.inc

include conf/machine/include/kona.inc

PAGE_SIZE ?= '4096'

# Max supported inodes
EXTRA_IMAGECMD ?= "-N 2048"

MACHINE_MNT_POINTS = "/firmware \
                      /dsp \
                      /bt_firmware \
                      /overlay \
                      /persist \
                     "

# Sizes for EXT4
SYSTEM_SIZE_EXT4 ?= "500MiB"
USERDATA_SIZE_EXT4 ?= "2GiB"

# Formats of root filesystem images.
IMAGE_FSTYPES += "ext4"

# Disable some default features supported from upstream
MACHINE_FEATURES_BACKFILL_CONSIDERED += "qemu-usermode rtc"
```

## conf/machine/include/telematics-hostvm.inc
```bitbake
MACHINE_FEATURES_append = " qti-vm-host qti-virtualization"

MACHINE_MNT_POINTS = " \
    /dsp \
    /firmware \
    /systemrw \
    /persist \
    /data \
    /cache \
    /vm-bootsys \
"
KERNEL_VARIANT_qti-distro-debug ??= "hostvm_debug_"
KERNEL_VARIANT_qti-distro-perf ??= "hostvm_perf_"

MACHINE_FEATURES_remove = "qti-wwan-plus-cv2x"
```

## conf/machine/include/telematics-vm.inc
```bitbake
require conf/machine/include/basemachine.inc

DEFAULTTUNE ?= "aarch64"
include conf/machine/include/arm/arch-armv8a.inc

PREFERRED_PROVIDER_virtual/kernel ?= "linux-msm"
PREFERRED_PROVIDER_virtual/mkbootimg-native ?= "mkbootimg-gki-native"
PREFERRED_PROVIDER_virtual/dtc-native ?= "dtc-android-build-native"
PREFERRED_PROVIDER_virtual/mkdtimg-native ?= "mkdtimg-gki-native"
PREFERRED_VERSION_linux-msm ?= "5.15"
PREFERRED_VERSION_linux-msm-headers ?= "5.15"
PREFERRED_VERSION_kernel-toolchain ?= "5.15"
PREFERRED_VERSION_dtc-android-build ?= "5.15"
PREFERRED_VERSION_mkbootimg-gki-native ?= "5.15"
PREFERRED_VERSION_dtc-android-build-native ?= "5.15"
PREFERRED_VERSION_mkdtimg-gki-native ?= "5.15"
PREFERRED_VERSION:securemsmdlkm ?= "1.0"

KERNEL_VARIANT = ""
KERNEL_VARIANT_qti-distro-debug = "debug_"
KERNEL_VARIANT_qti-distro-perf = "perf_"

PAGE_SIZE ?= '4096'

EXTRA_IMAGECMD ?= "-N 2048"

KERNEL_IMAGETYPE = "Image"
KERNEL_CMD_PARAMS = ""
KERNEL_DYNAMIC_DEFCONFIG = "True"
SERIAL_CONSOLE = "115200 hvc0"

MACHINE_FEATURES += "qti-vm-guest gh-loader qti-vm-systemrw tele-squashfs-ubi qti-sdx"

MACHINE_SUPPORTS_INIT_RAMDISK = "False"
TOYBOX_RAMDISK = "False"
MACHINE_USES_KERNEL_PREBUILTS = "True"
MACHINE_SUPPORTS_USB = "False"
MACHINE_SUPPORTS_PDMAPPER = "False"
MACHINE_SUPPORTS_DISPLAY = "False"
MACHINE_SUPPORTS_SECUREMSM = "False"
MACHINE_SUPPORTS_USB_AUTOSUSPEND = "False"

# Required to set service.adb.tcp.port for SVM
MACHINE_SUPPORTS_ANDROID_PROPERTIES = "True"

MACHINE_MNT_POINTS = " \
    /systemrw \
"

ENABLE_ADB = "True"

# Formats of root filesystem images.
IMAGE_FSTYPES += "ext4 ubi"
IMAGE_INIT_MANAGER = "systemd"

SYSTEMIMAGE_TARGET = "system.img"
VMIMAGE_TARGET = "vm-bootsys.img"
VMSYSTEMRW_TARGET = "vm-systemrw.img"

SYSTEMRW_SIZE_EXT4 = "10485760"
VM_SYSTEMRW_SIZE_EXT4 = "20971520"

VM_SPLIT_BINS_PATH = "boot"

# UBI arguments
UBINIZE_ARGS = "-m 4096 -p 256KiB -s 4096"
MKUBIFS_ARGS = "-m 4096 -e 253952 -c 2146 -F"

# On msm-5.4 or above ufs driver supports BSG Device.
UFS_BSG_DEV_USAGE = "True"

SYSTEMD_COREDUMP_PATH = "/systemrw/coredump"
```

## conf/machine/include/televm.inc
```bitbake
require conf/machine/include/basemachine.inc

DEFAULTTUNE ?= "aarch64"
include conf/machine/include/arm/arch-armv8a.inc

PREFERRED_PROVIDER_virtual/kernel ?= "linux-msm"
PREFERRED_PROVIDER_virtual/mkbootimg-native ?= "mkbootimg-gki-native"
PREFERRED_PROVIDER_virtual/dtc-native ?= "dtc-android-build-native"
PREFERRED_VERSION_linux-msm ?= "5.15"
PREFERRED_VERSION_linux-msm-headers ?= "5.15"
PREFERRED_VERSION_kernel-toolchain ?= "5.15"
PREFERRED_VERSION_dtc-android-build ?= "5.15"
PREFERRED_VERSION_mkbootimg-gki-native ?= "5.15"
PREFERRED_VERSION_dtc-android-build-native ?= "5.15"

KERNEL_VARIANT = ""
KERNEL_VARIANT_qti-distro-debug = "debug_"
KERNEL_VARIANT_qti-distro-perf = "perf_"

PAGE_SIZE ?= '4096'

EXTRA_IMAGECMD ?= "-N 2048"

KERNEL_IMAGETYPE = "Image"
KERNEL_CMD_PARAMS = ""
KERNEL_DYNAMIC_DEFCONFIG = "True"
SERIAL_CONSOLE = "115200 hvc0"
KERNEL_CONFIG ?= "vendor/sa410m_televm_defconfig"
KERNEL_CONFIG_qti-distro-debug ?= "vendor/sa410m_televm-debug_defconfig"

MACHINE_USES_KERNEL_PREBUILTS = "True"
MACHINE_SUPPORTS_USB = "False"
MACHINE_SUPPORTS_ANDROID_PROPERTIES = "False"
MACHINE_SUPPORTS_DISPLAY = "False"
MACHINE_SUPPORTS_SECUREMSM = "False"
MACHINE_MNT_POINTS = ""

# Formats of root filesystem images.
IMAGE_FSTYPES += "ext4"
IMAGE_INIT_MANAGER = "systemd"

SYSTEMIMAGE_TARGET = "system.img"
VMIMAGE_TARGET = "vm-bootsys.img"
VMIMAGE_FLAVOR = "televm"

# On msm-5.4 or above ufs driver supports BSG Device.
UFS_BSG_DEV_USAGE = "True"
```

## conf/machine/include/waipio.inc
```bitbake
SOC_FAMILY ?= "waipio"
include conf/machine/include/soc-family.inc

require conf/machine/include/arm/arch-armv8a.inc

# Set virtual providers
PREFERRED_PROVIDER_virtual/kernel = "linux-msm"
PREFERRED_PROVIDER_virtual/mkbootimg-native = "mkbootimg-gki-native"
PREFERRED_PROVIDER_virtual/dtc-native = "dtc-android-build-native"

# Set preferred versions
PREFERRED_VERSION_linux-msm = "5.10"
PREFERRED_VERSION_linux-msm-headers = "5.10"
PREFERRED_VERSION_kernel-toolchain-native = "5.10"
PREFERRED_VERSION_dtc-android-build-native = "1.6.0"
PREFERRED_VERSION_mkbootimg-gki-native = "5.10"

# Waipio abl expects boot image with header version set.
BOOT_HEADER_VERSION = "2"

# On msm-5.4 or above ufs driver supports BSG Device.
UFS_BSG_DEV_USAGE = "True"
```
