## conf/machine/mdm9607.conf
```bitbake
#@TYPE: Machine
#@NAME: MDM9607
#@DESCRIPTION: Machine configuration for QTI MDM9607

BASEMACHINE ?= "mdm9607"
require conf/machine/include/basemachine.inc

SOC_FAMILY ?= "mdm9x07"
include conf/machine/include/soc-family.inc

DEFAULTTUNE ?= "armv7athf-neon"
include conf/machine/include/arm/arch-armv7a.inc

PREFERRED_PROVIDER_virtual/kernel = "linux-msm"
PREFERRED_VERSION_linux-msm = "5.4"
PREFERRED_VERSION_linux-msm-headers = "5.4"

SERIAL_CONSOLES ?= "115200;ttyMSM0"
KERNEL_IMAGETYPE = "zImage"
KERNEL_BASE = "0x80000000"
KERNEL_TAGS_OFFSET = "0x81E00000"

KERNEL_DYNAMIC_DEFCONFIG = "True"
KERNEL_CONFIG ?= "vendor/mdm9607_auto_defconfig"
KERNEL_CONFIG_qti-distro-debug ?= "vendor/mdm9607_auto-debug_defconfig"
KERNEL_CMD_PARAMS = "noinitrd ro rootwait earlycon=msm_serial_dm,0x78b3000 console=ttyMSM0,115200,n8 androidboot.hardware=qcom androidboot.console=ttyMSM0 lpm_levels.sleep_disabled=1 service_locator.enable=1 firmware_class.path=/lib/firmware/updates msm_rtb.filter=0x237"

KERNEL_DTB_NAMES    = "\
                        vendor/qcom/mdm9607-cdp.dtb \
                        vendor/qcom/mdm9607-mtp.dtb \
                        vendor/qcom/mdm9607-mtp-sdcard.dtb \
                        vendor/qcom/mdm9607-rcm.dtb \
                        vendor/qcom/mdm9607-rumi.dtb \
                        vendor/qcom/mdm9607-ttp.dtb \
"

# Bootloader configuration
EXTRA_IMAGEDEPENDS += "lk"

# MACHINE_FEATURES ##
# qti-security:           Machine supports QTI security solution
# qti-wifi:               Machine supports QTI WiFi solution
# qti-audio:              Machine supports QTI audio solution
# qti-bluetooth:          Machine supports QTI bluetooth solution
# qti-location:           Machine supports Location solution
# qti-data-modem:         Machine supports QTI data modem solution

MACHINE_FEATURES += "qti-security qti-sdx dm-verity-none nand-boot qti-sensors qti-data-modem"

MACHINE_MNT_POINTS = " \
    /firmware \
    /persist \
    /cache \
    /data \
    /systemrw \
"

# Formats of root filesystem images
IMAGE_FSTYPES += "ubi"

# Sizes for UBI volumes
SYSTEM_VOLUME_SIZE ?= "120MiB"
CACHE_VOLUME_SIZE ?= "15MiB"
SYSTEMRW_VOLUME_SIZE ?= "6MiB"
PERSIST_VOLUME_SIZE ?= "6MiB"

PAGE_SIZE ?= '4096'
UBINIZE_ARGS ?= "-m 4096 -p 256KiB -s 4096"
MKUBIFS_ARGS ?= "-m 4096 -e 253952 -c 2146 -F"

MACHINE_SUPPORTS_PDMAPPER = "False"
MACHINE_SUPPORTS_INIT_RAMDISK = "False"
MACHINE_SUPPORTS_ANDROID_PROPERTIES = "False"

# Disable autosuspend for USB peripheral mode
MACHINE_SUPPORTS_USB_AUTOSUSPEND = "False"

# File indicating firmware residing places on device.
MACHINE_FILESMAP_CONF = "mdm9607-filesmap"

USBCOMPOSITION = "90DB"

# On msm-5.4 or above ufs driver supports BSG Device.
UFS_BSG_DEV_USAGE = "True"

PREFERRED_VERSION_openssl = "1.1.1s"
PREFERRED_VERSION_protobuf = "3.11.4"
PREFERRED_VERSION_protobuf-native = "3.11.4"
PREFERRED_VERSION_python3-protobuf = "3.11.3"
PREFERRED_VERSION_python3-protobuf-native = "3.11.3"
PREFERRED_VERSION_protobuf-c = "1.3.3"
PREFERRED_VERSION_iproute2 = "5.5.0"

# y2038: Support for Y2038 safe time on 32 bit systems
TARGET_CFLAGS += "-D_TIME_BITS=64 -D_FILE_OFFSET_BITS=64"
TARGET_CPPFLAGS += "-D_TIME_BITS=64 -D_FILE_OFFSET_BITS=64"
```

## conf/machine/mtp8909.conf
```bitbake
#@TYPE: Machine
#@NAME: mtp8909 dev kit
#@DESCRIPTION: Machine configuration for mtp8909 dev kit based on msm8909

require conf/machine/include/apq8009.inc

KERNEL_IMAGETYPE   = "zImage"
KERNEL_DTB_NAMES    = "qcom/msm8909-pm8916-mtp.dtb"
KERNEL_BASE        = "0x81C00000"
KERNEL_TAGS_OFFSET = "0x81900000"

KERNEL_CONFIG     ?= "msm8909-perf_defconfig"
KERNEL_CONFIG_qti-distro-debug ?= "msm8909_defconfig"

CONSOLE_PARAM     ?= ""
CONSOLE_PARAM_qti-distro-debug ?= "console=ttyMSM0,115200,n8"

KERNEL_CMD_PARAMS  = "root=/dev/mmcblk0p19  noinitrd ${CONSOLE_PARAM} androidboot.hardware=qcom ehci-hcd.park=3 msm_rtb.filter=0x237 lpm_levels.sleep_disabled=1 rootwait androidboot.bootdevice=7824900.sdhci firmware_class.path=/lib/firmware/updates rw"

SERIAL_CONSOLE    ?= ""
SERIAL_CONSOLE_qti-distro-debug ?= "115200 ttyMSM0"

# bootloader configuration
EXTRA_IMAGEDEPENDS += "lk"

# Conf with partition entries required for machine.
MACHINE_PARTITION_CONF = "mtp8909-partition.conf"

# File indicating firmware residing places on device.
MACHINE_FILESMAP_CONF = "apq8009-filesmap"

## Machine features ##
# emmc-boot:            Machine supports eMMC device
# qti-data-modem:       Machine supports QTI data modem solution
# qti-modem:            Machine supports QTI modem solution
# dm-verity-bootloader: Machine supports bootloader-based dm-verity implementation
#

MACHINE_FEATURES_append = " emmc-boot qti-data-modem qti-modem dm-verity-bootloader"
```
