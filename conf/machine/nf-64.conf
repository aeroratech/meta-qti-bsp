## conf/machine/sa415m.conf
```bitbake
#@TYPE: Machine
#@NAME: SA415M
#@DESCRIPTION: Machine configuration for QTI SA415M

BASEMACHINE ?= "sdxpoorwills"
require conf/machine/include/basemachine.inc

SOC_FAMILY ?= "mdm9x50"
include conf/machine/include/soc-family.inc

DEFAULTTUNE ?= "armv7athf-neon"
include conf/machine/include/arm/arch-armv7a.inc

PREFERRED_PROVIDER_virtual/kernel = "linux-msm"
PREFERRED_VERSION_linux-msm = "5.4"
PREFERRED_VERSION_linux-msm-headers = "5.4"
SERIAL_CONSOLES ?= "115200;ttyMSM0"
KERNEL_IMAGETYPE = "zImage"
KERNEL_BASE = "0x80000000"
KERNEL_TAGS_OFFSET = "0x82000000"

KERNEL_DYNAMIC_DEFCONFIG = "True"
KERNEL_CONFIG ?= "vendor/sa415m_auto_defconfig"
KERNEL_CONFIG_qti-distro-debug ?= "vendor/sa415m_auto-debug_defconfig"
KERNEL_CMD_PARAMS = "noinitrd ro rootwait console=ttyMSM0,115200,n8 no_console_suspend=1 androidboot.hardware=qcom androidboot.console=ttyMSM0 lpm_levels.sleep_disabled=1 service_locator.enable=1 firmware_class.path=/lib/firmware/updates msm_rtb.filter=0x237"

KERNEL_DTB_NAMES    = "\
                        vendor/qcom/sa415m-ccard.dtb \
                        vendor/qcom/sa415m-ccard-usb-ep.dtb \
                        vendor/qcom/sa415m-ccard-ga.dtb \
                        vendor/qcom/sa415m-ccard-pcie-ep.dtb \
                        vendor/qcom/sa415m-ccard-usb-ep-ga.dtb \
                        vendor/qcom/sa415m-cdp.dtb \
                        vendor/qcom/sa415m-mtp-256.dtb \
                        vendor/qcom/sa415m-ttp-pcie-ep.dtb \
                        vendor/qcom/sa415m-ttp-usb-ep.dtb \
                        vendor/qcom/sa415m-ttp.dtb \
                        vendor/qcom/sa415m-v2-cdp.dtb \
                        vendor/qcom/sa415m-v2-mtp.dtb \
"

# Bootloader configuration
EXTRA_IMAGEDEPENDS += "edk2"

# MACHINE_FEATURES ##
# qti-security:           Machine supports QTI security solution
# qti-wifi:               Machine supports QTI WiFi solution
# qti-audio:              Machine supports QTI audio solution
# qti-bluetooth:          Machine supports QTI bluetooth solution
# qti-location:           Machine supports Location solution
# qti-data-modem:         Machine supports QTI data modem solution

MACHINE_FEATURES += "qti-security qti-sdx dm-verity-none qti-data-modem norpmb_listener nossd_listener legacy_kmlite le_qseecom qti-audio qti-recovery qti-location qwesd qwes_legacy qti-wlan qti-wwan-plus-cv2x qti-sensors"

CONFLICT_MACHINE_FEATURES += "qti-cv2x"

MACHINE_MNT_POINTS = " \
    /firmware \
    /persist \
    /cache \
    /data \
    /systemrw \
"

# Formats of root filesystem images
IMAGE_FSTYPES += "ubi"

# Sizes for UBI volumes
SYSTEM_VOLUME_SIZE ?= "110MiB"
CACHE_VOLUME_SIZE ?= "15MiB"
SYSTEMRW_VOLUME_SIZE ?= "6MiB"
PERSIST_VOLUME_SIZE ?= "6MiB"

PAGE_SIZE ?= '4096'
UBINIZE_ARGS ?= "-m 4096 -p 256KiB -s 4096"
MKUBIFS_ARGS ?= "-m 4096 -e 253952 -c 2146 -F"

MACHINE_SUPPORTS_PDMAPPER = "False"
MACHINE_SUPPORTS_INIT_RAMDISK = "False"
MACHINE_SUPPORTS_ANDROID_PROPERTIES = "False"

# File indicating firmware residing places on device.
MACHINE_FILESMAP_CONF = "sa415m-filesmap"

USBCOMPOSITION = "90DB"

# On msm-5.4 or above ufs driver supports BSG Device.
UFS_BSG_DEV_USAGE = "True"

PREFERRED_VERSION_protobuf = "3.11.4"
PREFERRED_VERSION_protobuf-native = "3.11.4"
PREFERRED_VERSION_iproute2 = "5.5.0"

# y2038: Support for Y2038 safe time on 32 bit systems
TARGET_CFLAGS += "-D_TIME_BITS=64 -D_FILE_OFFSET_BITS=64"
TARGET_CPPFLAGS += "-D_TIME_BITS=64 -D_FILE_OFFSET_BITS=64"
```

## conf/machine/sa515m.conf
```bitbake
#@TYPE: Machine
#@NAME: SA515M
#@DESCRIPTION: Machine configuration for QTI SA515M

BASEMACHINE ?= "sdxprairie"
require conf/machine/include/basemachine.inc

SOC_FAMILY ?= "mdm9x50"
include conf/machine/include/soc-family.inc

DEFAULTTUNE ?= "armv7athf-neon"
include conf/machine/include/arm/arch-armv7a.inc

PREFERRED_PROVIDER_virtual/kernel = "linux-msm"
PREFERRED_VERSION_linux-msm = "5.4"
PREFERRED_VERSION_linux-msm-headers = "5.4"
SERIAL_CONSOLES ?= "115200;ttyMSM0"
KERNEL_IMAGETYPE = "zImage-dtb"
KERNEL_BASE = "0x80000000"
KERNEL_TAGS_OFFSET = "0x82000000"

KERNEL_DYNAMIC_DEFCONFIG = "True"
KERNEL_CONFIG ?= "vendor/sa515m_auto_defconfig"
KERNEL_CONFIG_qti-distro-debug ?= "vendor/sa515m_auto-debug_defconfig"
KERNEL_CMD_PARAMS = "noinitrd ro rootwait console=ttyMSM0,115200,n8 no_console_suspend=1 androidboot.hardware=qcom androidboot.console=ttyMSM0 lpm_levels.sleep_disabled=1 service_locator.enable=1 firmware_class.path=/lib/firmware/updates msm_rtb.filter=0x237"

KERNEL_DTB_NAMES    = "vendor/qcom/sa515m-ccard.dtb"

# Bootloader configuration
EXTRA_IMAGEDEPENDS += "edk2"

# MACHINE_FEATURES ##
# qti-security:           Machine supports QTI security solution
# qti-wifi:               Machine supports QTI WiFi solution
# qti-audio:              Machine supports QTI audio solution
# qti-bluetooth:          Machine supports QTI bluetooth solution
# qti-location:           Machine supports Location solution
# qti-data-modem:         Machine supports QTI data modem solution

MACHINE_FEATURES += "qti-security qti-sdx dm-verity-none qti-location qti-recovery qwesd qwes_legacy qti-bluetooth qti-audio"

MACHINE_MNT_POINTS = " \
    /firmware \
    /persist \
    /cache \
    /data \
    /systemrw \
"

# Formats of root filesystem images
IMAGE_FSTYPES += "ubi"

# Sizes for UBI volumes
SYSTEM_VOLUME_SIZE ?= "110MiB"
CACHE_VOLUME_SIZE ?= "15MiB"
SYSTEMRW_VOLUME_SIZE ?= "6MiB"
PERSIST_VOLUME_SIZE ?= "6MiB"

PAGE_SIZE ?= '4096'
UBINIZE_ARGS ?= "-m 4096 -p 256KiB -s 4096"
MKUBIFS_ARGS ?= "-m 4096 -e 253952 -c 2146 -F"

MACHINE_SUPPORTS_PDMAPPER = "False"
MACHINE_SUPPORTS_INIT_RAMDISK = "False"
MACHINE_SUPPORTS_ANDROID_PROPERTIES = "False"

# File indicating firmware residing places on device.
MACHINE_FILESMAP_CONF = "sa515m-filesmap"

USBCOMPOSITION = "90DB"

# On msm-5.4 or above ufs driver supports BSG Device.
UFS_BSG_DEV_USAGE = "True"

PREFERRED_VERSION_protobuf = "3.11.4"
PREFERRED_VERSION_protobuf-native = "3.11.4"
PREFERRED_VERSION_iproute2 = "5.5.0"
```

## conf/machine/sa525m-emmc.conf
```bitbake
#@TYPE: Machine
#@NAME: SA525M-EMMC
#@DESCRIPTION: Machine configuration for SA525M EMMC

require conf/machine/include/sa525m.inc

# MACHINE_FEATURES ##
MACHINE_FEATURES += "emmc-boot"

# Sizes for EXT4 (in bytes)
SYSTEM_SIZE_EXT4  ?= "268435456"
USERDATA_SIZE_EXT4 ?= "251658240"

# Formats of root filesystem images
IMAGE_FSTYPES += "ext4"
MACHINE_SUPPORTS_INIT_RAMDISK = "True"
TOYBOX_RAMDISK = "True"
MACHINE_FSCONFIG_CONF = "sa525m-emmc-fsconfig.conf"

# File indicating firmware residing places on device.
MACHINE_FILESMAP_CONF = "sa525m-emmc-filesmap"
```

## conf/machine/sa525m-fotavm.conf
```bitbake
#@TYPE: Machine
#@NAME: SA525M-FOTAVM
#@DESCRIPTION: Machine configuration for QTI TELEMATICS VM on SA525M

BASEMACHINE ?= "sa525m"

require conf/machine/include/telematics-vm.inc

KERNEL_BASE = "0x0"
KERNEL_OFFSET = "0"
DTB_OFFSET = "0x2000000"
RAMDISK_OFFSET = "0x2100000"

KERNEL_PREBUILT_PATH = "${WORKSPACE}/kernel-5.15/out/msm-kernel-sa525m_fotavm-${KERNEL_VARIANT}defconfig/dist"
KERNEL_OUT_PATH = "${WORKSPACE}/kernel-5.15/out/msm-kernel-sa525m_fotavm-${KERNEL_VARIANT}defconfig"
KERNEL_BUILD_CONFIG = "msm-kernel/build.config.msm.sa525m.fotavm"

KERNEL_DTB_NAMES    = "vendor/qcom/sa525m-fotavm.dtb"
DTB_TARGET = "vm.dtb"

KERNEL_CONFIG = "vendor/sa525m_fotavm_defconfig"
KERNEL_CONFIG_qti-distro-debug = "vendor/sa525m_fotavm-debug_defconfig"

MACHINE_FEATURES += "qti-vm-fota"

# Ramdisk size is 8 MB
RAMDISK_SIZE = "8388608"

# 95MB
SYSTEM_SIZE_EXT4 ?= "99614720"

# 120MB
VM_SIZE_EXT4 ?= "125829120"

VM_IMAGE_NAME="fotavm"
VMIMAGE_FLAVOR = "fotavm"

MACHINE_FEATURES += "gh-loader"
# filesystem configurations to be applied on image.
MACHINE_FSCONFIG_CONF = "sa525m-emmc-fsconfig.conf"
```

## conf/machine/sa525m-televm.conf
```bitbake
#@TYPE: Machine
#@NAME: SA525M-TELEVM
#@DESCRIPTION: Machine configuration for QTI TELEMATICS VM on SA525M

BASEMACHINE ?= "sa525m"

require conf/machine/include/telematics-vm.inc

KERNEL_BASE = "0x0"
KERNEL_OFFSET = "0"
DTB_OFFSET = "0x2000000"
RAMDISK_OFFSET = "0x2100000"

KERNEL_PREBUILT_PATH = "${WORKSPACE}/kernel-5.15/out/msm-kernel-sa525m_televm-${KERNEL_VARIANT}defconfig/dist"
KERNEL_OUT_PATH = "${WORKSPACE}/kernel-5.15/out/msm-kernel-sa525m_televm-${KERNEL_VARIANT}defconfig"
KERNEL_BUILD_CONFIG = "msm-kernel/build.config.msm.sa525m.televm"

KERNEL_DTB_NAMES    = "vendor/qcom/sa525m-televm.dtb"
DTB_TARGET = "vm.dtb"

KERNEL_CONFIG = "vendor/sa525m_televm_defconfig"
KERNEL_CONFIG_qti-distro-debug = "vendor/sa525m_televm-debug_defconfig"

MACHINE_FEATURES += "qti-vm-tele"

# Ramdisk size is 8 MB
RAMDISK_SIZE = "8388608"

#150MB
SYSTEM_SIZE_EXT4 ?= "157286400"

#183MB
VM_SIZE_EXT4 ?= "191889408"

VM_IMAGE_NAME="televm"
VMIMAGE_FLAVOR = "televm"

MACHINE_FEATURES += "gh-loader qti-smciqseecomd qseecompat"
# filesystem configurations to be applied on image.
MACHINE_FSCONFIG_CONF = "sa525m-emmc-fsconfig.conf"

MACHINE_SUPPORTS_SECUREMSM = "True"
```
