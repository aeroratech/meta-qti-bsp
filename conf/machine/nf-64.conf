## conf/machine/nf-64.conf
```bitbake
#@TYPE: Machine
#@NAME: SOM2-QCS403
#@DESCRIPTION: Machine configuration for QTI SOM2-QCS403
require conf/machine/include/qcs40x.inc
# NAND TARGET TO SUPPORT 32-bit kernel
DISTRO = "qsap"
DEFAULTTUNE = "aarch64"

DISTRO_FEATURES += "nand-boot"
DISTRO_FEATURES_NATIVE_append = " nand-boot "

PAGE_SIZE ?= '4096'
PRODUCT_TYPE = "speaker"

#Final system volume name.
OUTPUT_FILE_FINAL_SQUASHFS_UBI = "${DEPLOY_DIR_IMAGE}/system.ubi"

#boot image
BOOTIMAGE_TARGET = "boot.img"

#system volume name
SQUASHFS_SYS_VOLUME = "system.squash"

# usrfs volume.
USR_IMAGE_BASENAME       = "userdata"

# persist volume = "persist.ubifs"
OUTPUT_FILE_PERSIST_UBIFS = "${DEPLOY_DIR_IMAGE}/persist.ubifs"

# Max supported inodes
EXTRA_IMAGECMD ?= "-N 2048"
#UBINIZE Args
UBINIZE_ARGS ?= "-m 4096 -p 256KiB -s 4096"
#MKUBIFS Args
MKUBIFS_ARGS ?= "-m 4096 -e 253952 -c 2146 -F"

MACHINE_MNT_POINTS = "/firmware /persist /cache /dsp /bt_firmware"

#Volume sizes
CACHE_VOLUME_SIZE ?= "81MiB"
SYSTEMRW_VOLUME_SIZE ?= "6MiB"
PERSIST_VOLUME_SIZE ?= "12MiB"
# Formats of root filesystem images.
IMAGE_FSTYPES += "ubi"

# Limiting squashfs rootfs size to 75MiB (size should be multiple of LEB, LEB is 253952 bytes)
SYSTEM_SQUASHFS_VOLUME_SIZE = "110725120"

#Disable ssd listener
DISTRO_FEATURES_append = " no-ssd-listener-support"

#Disable rpmb listener
DISTRO_FEATURES_append = " no-rpmb-listener-support"

# enable audio as a loadable kernel module
DISTRO_FEATURES_append = " audio-dlkm"

#For NAND target use persist as a volume instead of partition.
DISTRO_FEATURES_append = " persist-volume"

#nand-squashfs enables squashfs rootfs on NAND targets
DISTRO_FEATURES_append = " nand-squashfs"
MKUBIFS_PERSIST_ARGS = "-m 4096 -e 253952 -c 2146 -F"
RECOVERY_IMAGE = "0"

KERNEL_IMAGETYPE = "Image.gz-dtb"


require conf/multilib.conf
MULTILIBS = "multilib:lib32"
DEFAULTTUNE_virtclass-multilib-lib32 = "armv7ahf-neon"
TARGET_VENDOR_virtclass-multilib-lib32="-oe"

# Flag to Enable QPermissions
QPERMISSIONS_ENABLE = "1"

QPERM_FILE_pn-start-script-ab-slot-util = "${bindir}/getslotsuffix:root:system"
QPERM_FILE_pn-system-core = "${sysconfdir}/build.prop:leprop:leprop"
QPERM_FILE_pn-system-prop = "/build.prop:leprop:leprop"

#qti-audiopd ensures audiopd is supported by adsp"
#qti-cdsp ensures cdsp subsystem is supported.
DISTRO_FEATURES_append = " no-test-bundle qti-audiopd "

#qti-cdsp ensures cdsp subsystem is supported.
MACHINE_FEATURES_append = " qti-cdsp "
```

## conf/machine/open-q-212a-homehub.conf
```bitbake
#@TYPE: Machine
#@NAME: open-q-212a-homehub dev kit
#@DESCRIPTION: Machine configuration for open-q-212a-homehub dev kit based on APQ8009

require conf/machine/include/apq8009.inc

KERNEL_IMAGETYPE   = "zImage"
KERNEL_DTB_NAMES    = "qcom/apq8009-robot-som-refboard.dtb"
KERNEL_BASE        = "0x81C00000"
KERNEL_TAGS_OFFSET = "0x81900000"

KERNEL_CONFIG     ?= "msm8909-minimal-perf_defconfig"
KERNEL_CONFIG_qti-distro-debug ?= "msm8909-minimal_defconfig"

CONSOLE_PARAM     ?= ""
CONSOLE_PARAM_qti-distro-debug ?= "console=ttyMSM0,115200,n8"

KERNEL_CMD_PARAMS  = "noinitrd ${CONSOLE_PARAM} androidboot.hardware=qcom ehci-hcd.park=3 msm_rtb.filter=0x37 lpm_levels.sleep_disabled=1 rootwait androidboot.bootdevice=7824900.sdhci firmware_class.path=/lib/firmware/updates rw"

SERIAL_CONSOLE    ?= ""
SERIAL_CONSOLE_qti-distro-debug ?= "115200 ttyMSM0"

PREFERRED_VERSION_linux-msm           = "4.9"
PREFERRED_PROVIDER_virtual/bootloader = "lk"

# Conf with partition entries required for machine.
MACHINE_PARTITION_CONF = "${COREBASE}/meta-qti-bsp/conf/machine/partition/${MACHINE}-partition.conf"

# filesystem configurations to be applied on image.
MACHINE_FSCONFIG_CONF = "apq8009-fsconfig.conf"

## MACHINE_FEATURES ##

# WLAN soc is naples.
MACHINE_FEATURES_append = " fbdev mm-camera naples qti-bluetooth qti-camera qti-display qti-video qti-wifi"

MACHINE_FEATURES_BACKFILL_CONSIDERED += "qemu-usermode"
```

## conf/machine/qcs404-rb1.conf
```bitbake
#@TYPE: Machine
#@NAME: RB1-QCS404
#@DESCRIPTION: Machine configuration for QTI RB1-QCS404

require conf/machine/include/qcs40x.inc

KERNEL_IMAGETYPE = "Image.gz"
KERNEL_DTB_NAMES    = "qcom/qcs405-iot-robot-reference-board.dtb qcom/qcs404-iot-robot-reference-board.dtb"
KERNEL_BASE = "0x80000000"
KERNEL_TAGS_OFFSET = "0x1e00000"

KERNEL_CONFIG ?= "vendor/qcs405-perf_defconfig"
KERNEL_CONFIG_qti-distro-debug ?= "vendor/qcs405_defconfig"

CONSOLE_PARAM ?= ""
CONSOLE_PARAM_qti-distro-debug ?= "console=ttyMSM0,115200,n8"

KERNEL_CMD_PARAMS ?= "noinitrd rw rootwait ${CONSOLE_PARAM} no_console_suspend=1 androidboot.hardware=qcom androidboot.console=ttyMSM0 lpm_levels.sleep_disabled=1 service_locator.enable=1 firmware_class.path=/lib/firmware/updates msm_rtb.filter=0x237"

SERIAL_CONSOLE ?= ""
SERIAL_CONSOLE_qti-distro-debug ?= "115200 ttyMSM0"

PREFERRED_VERSION_linux-msm = "4.14"
PREFERRED_PROVIDER_virtual/bootloader = "edk2"

# Flag to Enable QPermissions
QPERMISSIONS_ENABLE = "1"

# Conf with partition entries required for machine.
MACHINE_PARTITION_CONF = "qcs404-rb1-partition.conf"

# filesystem configurations to be applied on image.
MACHINE_FSCONFIG_CONF = "qcs40x-fsconfig.conf"

## Machine features ##
# qti-cdsp:      Machine supports QTI cdsp solution
# qti-cherokee:  Supported WLAN soc in this machine is cherokee
# qti-wifi:      Machine supports QTI WiFi solution
# tflite-hw-delegate: GPU/DSP delegation is supported in tensorflow lite
# qti-audio:     Machine supports QTI audio solution
# qti-adsp:      Machine supports QTI adsp solution
#

MACHINE_FEATURES_append = " qti-cdsp qti-wifi qti-cherokee tflite-hw-delegate qti-audio qti-adsp"
```

## conf/machine/qcs405-som1.conf
```bitbake
#@TYPE: Machine
#@NAME: SOM1-QCS405
#@DESCRIPTION: Machine configuration for QTI SOM1-QCS405
require conf/distro/include/debug_flags.inc
require conf/machine/include/qcs40x.inc

# The incremental build solution causes issues for a few recipes
# hence temporarily disabled
BB_SIGNATURE_HANDLER = "noop"

# EMMC TARGET TO SUPPORT 64-bit kernel
DISTRO = "qsap"
DEFAULTTUNE = "aarch64"

MACHINE_MNT_POINTS = "/firmware /persist /cache /dsp /bt_firmware"

# Sizes for EXT4 (in bytes)
SYSTEM_SIZE_EXT4 ?= "${@bb.utils.contains('DEBUG_BUILD', '1', '5368709120', '681574400', d)}"
SYSTEMRW_SIZE_EXT4 ?= "8388608"
USERDATA_SIZE_EXT4 ?= "${@bb.utils.contains('DEBUG_BUILD', '1', '100000000', '2000000000', d)}"
CACHE_SIZE_EXT4 ?= "80000000"

# enable audio as a loadable kernel module
DISTRO_FEATURES_append = " audio-dlkm"

#enable selinux
DISTRO_FEATURES_append = " selinux"
DEFAULT_ENFORCING = "enforcing"

#Enable dm-verity feature for non debug builds
DISTRO_FEATURES += "${@bb.utils.contains('DEBUG_BUILD', '1', '', 'dm-verity', d)}"

# Formats of root filesystem images.
IMAGE_FSTYPES += "ext4"
RECOVERY_IMAGE = "0"

KERNEL_IMAGETYPE = "Image.gz-dtb"
IMAGE_EXT4_EXTRA_OPTIONS = "${@bb.utils.contains('DISTRO_FEATURES','ro-rootfs',' -J -b 4096 ','',d)}"
DISTRO_FEATURES += "persist-image"
require conf/multilib.conf
MULTILIBS = "multilib:lib32"
DEFAULTTUNE_virtclass-multilib-lib32 = "armv7ahf-neon"
TARGET_VENDOR_virtclass-multilib-lib32="-oe"

PREFERRED_PROVIDER_virtual/libgles1 = "adreno"
PREFERRED_PROVIDER_virtual/libgles2 = "adreno"
PREFERRED_PROVIDER_virtual/egl      = "adreno"

# Set ab-boot-support feature for native tools as well,
# as some native tools have workflow chnages for AB builds.
DISTRO_FEATURES += "ab-boot-support"
DISTRO_FEATURES_NATIVE_append = " ab-boot-support "


# Flag to Enable QPermissions
QPERMISSIONS_ENABLE = "1"

QPERM_FILE_pn-start-script-ab-slot-util = "${bindir}/getslotsuffix:root:system"
QPERM_FILE_pn-system-core = "${sysconfdir}/build.prop:leprop:leprop"
QPERM_FILE_pn-system-prop = "/build.prop:leprop:leprop"

PREFERRED_PROVIDER_virtual/wpebackend = "wpebackend-rdk"
```

## conf/machine/qcs610-odk-64.conf
```bitbake
#@TYPE: Machine
#@NAME: qcs610-odk (64-bit)
#@DESCRIPTION: Machine configuration for qcs610-odk in 64 bits mode

require conf/machine/include/qcs610.inc

MACHINE_SUPPORTS_DTBO  = "True"

KERNEL_DTB_NAMES = "${@bb.utils.contains('MACHINE_SUPPORTS_DTBO', 'True', "${DTBO_DTB_NAMES}", "${NON_DTBO_DTB_NAMES}", d)}"

KERNEL_IMAGETYPE   = "Image.gz"
DTBO_DTB_NAMES     = "vendor/qcom/qcs610.dtb vendor/qcom/qcs410.dtb"
NON_DTBO_DTB_NAMES = "vendor/qcom/qcs610-iot.dtb vendor/qcom/qcs410-opk.dtb"
KERNEL_BASE        = "0x80000000"
KERNEL_TAGS_OFFSET = "0x81e00000"

KERNEL_CONFIG ?= "vendor/sm6150-qgki_defconfig"
TARGET_BUILD_VARIANT ?= "user"
KERNEL_CONFIG_qti-distro-debug ?= "vendor/sm6150-qgki-debug_defconfig"
TARGET_BUILD_VARIANT_qti-distro-debug ?= "debug"

CONSOLE_PARAM ?= ""
CONSOLE_PARAM_qti-distro-debug ?= "console=ttyMSM0,115200,n8"

KERNEL_CMD_PARAMS ?= "noinitrd rootwait ${CONSOLE_PARAM} androidboot.hardware=qcom androidboot.console=ttyMSM0 lpm_levels.sleep_disabled=1 service_locator.enable=1 firmware_class.path=/lib/firmware/updates msm_rtb.filter=0x237"

SERIAL_CONSOLE    ?= ""
SERIAL_CONSOLE_qti-distro-debug ?= "115200 ttyMSM0"

# bootloader configuration
EXTRA_IMAGEDEPENDS += "edk2"

# Conf with partition entries required for machine.
MACHINE_PARTITION_CONF = "qcs610-odk-partition.conf"

# filesystem configurations to be applied on image.
MACHINE_FSCONFIG_CONF = "qcs610-fsconfig.conf"

# File indicating firmware residing places on device.
MACHINE_FILESMAP_CONF = "qcs610-filesmap"

# Build architecture configuration
DEFAULTTUNE = "aarch64"

KERNEL_DYNAMIC_DEFCONFIG = "True"


## Machine features ##
# emmc-boot:             Machine supports eMMC device
# drm:                   Machine supports DRM display drivers
# ubwc:                  Machine supports UBWC hardware
# qti-emac-dwc-eqos:     Machine supports emac-dwc-eqos driver
# qti-afr-algo:  Support QTI Auto framing algo
# qti-audio:             Machine supports QTI audio solution
# qti-bluetooth:         Machine supports QTI bluetooth solution
# qti-camera:            Machine supports QTI camera solution
# qti-cdsp:              Machine supports QTI cdsp solution
# qti-adsp:              Machine supports QTI adsp solution
# qti-ab-boot:           Machine supports a/b boot solution
# qti-display:           Machine supports QTI display solution
# qti-helium:            Machine supports QTI helium WiFi target
# qti-sensors:           Machine supports sensors qti solution
# tflite-hw-delegate:    Machine supports TFlite hardware delegates
# qti-tflite-delegate:   Machine supports Tensorflow lite hardware delegates
# qti-video:             Machine supports QTI video solution
# qti-wifi:              Machine supports wifi solution
# opencl:                Machine supports OpenCL driver
# dm-verity-bootloader:  Machine supports bootloader-based dm-verity implementation
# qti-location:          Machine supports Location solution

MACHINE_FEATURES_append = " emmc-boot drm ubwc qti-audio qti-afr-algo qti-camera qti-cdsp qti-adsp qti-ab-boot qti-display qti-helium qti-sensors tflite-hw-delegate qti-tflite-delegate opencl qti-security qti-video dm-verity-bootloader qti-location qti-wifi"
```

## conf/machine/qcs610-odk.conf
```bitbake
#@TYPE: Machine
#@NAME: qcs610-odk
#@DESCRIPTION: Machine configuration for qcs610-odk

require conf/machine/include/qcs610.inc

KERNEL_IMAGETYPE   = "Image.gz"
KERNEL_DTB_NAMES   = "qcom/qcs610-iot.dtb qcom/qcs410-iot.dtb"
KERNEL_BASE        = "0x80000000"
KERNEL_TAGS_OFFSET = "0x81e00000"

KERNEL_CONFIG ?= "vendor/sdmsteppe-perf_defconfig"
KERNEL_CONFIG_qti-distro-debug ?= "vendor/sdmsteppe_defconfig"

CONSOLE_PARAM ?= ""
CONSOLE_PARAM_qti-distro-debug ?= "console=ttyMSM0,115200,n8"

KERNEL_CMD_PARAMS ?= "noinitrd rootwait ${CONSOLE_PARAM} no_console_suspend=1 androidboot.hardware=qcom androidboot.console=ttyMSM0 lpm_levels.sleep_disabled=1 service_locator.enable=1 firmware_class.path=/lib/firmware/updates msm_rtb.filter=0x237"

SERIAL_CONSOLE    ?= ""
SERIAL_CONSOLE_qti-distro-debug ?= "115200 ttyMSM0"

# bootloader configuration
EXTRA_IMAGEDEPENDS += "lib64-edk2"

# Conf with partition entries required for machine.
MACHINE_PARTITION_CONF = "qcs610-odk-partition.conf"

# filesystem configurations to be applied on image.
MACHINE_FSCONFIG_CONF = "qcs610-fsconfig.conf"

# Multilib configuration
DEFAULTTUNE = "armv7ahf-neon"
TARGET_KERNEL_ARCH = "aarch64"
require conf/multilib.conf
MULTILIBS = "multilib:lib64"
DEFAULTTUNE_virtclass-multilib-lib64 = "aarch64"
TARGET_VENDOR_virtclass-multilib-lib64="-oe"

## Machine features ##
# drm:                   Machine supports DRM display drivers
# qti-emac-dwc-eqos:     Machine supports emac-dwc-eqos driver
# qti-audio:             Machine supports QTI audio solution
# qti-audio-cal:         Machine supports QTI audio calibration solution
# qti-audio-encoder:     Machine supports QTI audio encoder solution
# qti-cdsp:              Machine supports QTI cdsp solution
# qti-adsp:              Machine supports QTI adsp solution
# qti-ab-boot:           Machine supports a/b boot solution
# qti-helium:            Machine supports QTI helium WiFi target
# qti-sensors:           Machine supports sensors qti solution
# tflite-hw-delegate:    Machine supports TFlite hardware delegates
# qti-tflite-delegate:   Machine supports Tensorflow lite hardware delegates
# qti-wifi:              Machine supports wifi solution
# opencl:                Machine supports OpenCL driver

MACHINE_FEATURES_append = " drm qti-emac-dwc-eqos qti-audio qti-audio-cal qti-audio-encoder qti-cdsp qti-adsp qti-ab-boot qti-helium qti-sensors tflite-hw-delegate qti-wifi qti-tflite-delegate opencl qti-security"
```
