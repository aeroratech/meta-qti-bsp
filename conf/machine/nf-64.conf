## conf/machine/qcs6490-odk.conf
```bitbake
#@TYPE: Machine
#@NAME: C6490 dev kit
#@DESCRIPTION: Machine configuration for C6490 dev kit based on QCS6490

require conf/machine/include/qcs6490.inc

MACHINE_SUPPORTS_DTBO  = "True"
ENABLE_ABL_SAFESTACK = "True"
ENABLE_SAFESTACK_SUPPORTED_CLANG_VERSION = "6.0"
KERNEL_IMAGETYPE   = "Image.gz"
KERNEL_DTB_NAMES   = "${@bb.utils.contains('MACHINE_SUPPORTS_DTBO', 'True', "${DTBO_DTB_NAMES}", "${NON_DTBO_DTB_NAMES}", d)}"
DTBO_DTB_NAMES     = "vendor/qcom/katmai-odk.dtb vendor/qcom/katmai-fp2-odk.dtb vendor/qcom/yupik-odk.dtb vendor/qcom/yupik-iot.dtb vendor/qcom/yupikp-iot.dtb vendor/qcom/yupik.dtb vendor/qcom/yupik-hsp.dtb vendor/qcom/yupikp.dtb vendor/qcom/yupikp-hsp.dtb vendor/qcom/katmai.dtb vendor/qcom/katmai-fp2.dtb vendor/qcom/katmaip.dtb vendor/qcom/katmaip-fp2.dtb"
NON_DTBO_DTB_NAMES = "vendor/qcom/yupik-iot-odk-hdmi.dtb vendor/qcom/yupik-iot-odk-lcd.dtb vendor/qcom/katmai-iot-odk-lcd.dtb vendor/qcom/katmai-iot-odk-hdmi.dtb vendor/qcom/katmai-fp2-iot-odk-lcd.dtb vendor/qcom/katmai-fp2-iot-odk-hdmi.dtb"
KERNEL_BASE        = "0x80000000"
KERNEL_TAGS_OFFSET = "0x81900000"

KERNEL_CONFIG     = "vendor/lahaina-qgki_defconfig"
KERNEL_CONFIG_qti-distro-debug = "vendor/lahaina-qgki-debug_defconfig"

CONSOLE_PARAM     ?= ""
CONSOLE_PARAM_qti-distro-debug ?= "console=ttyMSM0,115200,n8"

KERNEL_CMD_PARAMS  = "noinitrd ${CONSOLE_PARAM} earlycon=msm_geni_serial,0x994000 androidboot.hardware=qcom androidboot.console=ttyMSM0 androidboot.memcg=1 lpm_levels.sleep_disabled=1 video=vfb:640x400,bpp=32,memsize=3072000 msm_rtb.filter=0x237 service_locator.enable=1 androidboot.usbcontroller=a600000.dwc3 swiotlb=2048 loop.max_part=7 cgroup.memory=nokmem,nosocket reboot=panic_warm net.ifnames=0"

SERIAL_CONSOLE    ?= ""
SERIAL_CONSOLE_qti-distro-debug ?= "115200 ttyMSM0"

KERNEL_DYNAMIC_DEFCONFIG = "True"

# bootloader configuration
EXTRA_IMAGEDEPENDS += "edk2"

PREFERRED_PROVIDER_virtual/libgles1 = "adreno"
PREFERRED_PROVIDER_virtual/libgles2 = "adreno"
PREFERRED_PROVIDER_virtual/egl      = "adreno"

# Conf with partition entries required for machine.
MACHINE_PARTITION_CONF = "qcs6490-odk-partition.conf"

# filesystem configurations to be applied on image.
MACHINE_FSCONFIG_CONF = "qcs6490-fsconfig.conf"

# File indicating firmware residing places on device.
MACHINE_FILESMAP_CONF = "qcs6490-filesmap"

# Sizes for EXT4 (in bytes)
SYSTEM_SIZE_EXT4 = "8589934592"
USERDATA_SIZE_EXT4 = "103079215104"

# MACHINE_FEATURES ##
# emmc-boot:            Machine supports eMMC device
# ubwc:                 Machine supports UBWC hardware
# qti-wifi:             Machine supports QTI WiFi solution
# qti-audio:            Machine supports QTI audio solution
# qti-audio-encoder:    Machine supports QTI audio encoder
# qti-audio-cal:        Machine supports QTI audio calibration solution
# qti-adsp:             Machine supports QTI adsp solution
# qti-cvp:              Machine supports QTI cvp solution
# qti-ab-boot:          Machine support a/b boot
# opencl:               Machine supports OpenCL driver
# qti-tflite-delegate:  Machine supports tensorflow lite hardware acceleration
# drm :                 Machine supports DRM display drivers
# dm-verity-bootloader: Machine supports bootloader-based dm-verity implementation
# qti-security:         Support QTI security solution
# qti-gst-ros2:         Machine supports QTI Gst Ros2 solution
# qti-fscrypt:          Machine supports FBE using fscrypt
# le_qseecom:           Machine supports LE similar solution of qseecom
# qwesd:                Machine supports qwes service, required by softSKU
# qti-location:         Machine supports Location solution
# qti-uvc:              Machine supports QTI UVC solution

MACHINE_FEATURES += "emmc-boot ubwc hasting qti-adsp qti-audio qti-audio-encoder \
                     qti-audio-cal qti-ab-boot qti-cdsp opencl \
                     qti-camera qti-vfw drm qti-security dm-verity-bootloader \
                     qti-slpi qti-video qti-fscrypt qti-wifi qti-bluetooth \
                     qti-gst-ros2 qti-sensors qti-display qti-uvc \
                     le_qseecom qwesd qti-location"

# Disable compilation temporarily
DISTRO_FEATURES_remove = " \
    vslam \
    librealsense2 \
    tdk-sensors \
    auto-explore \
    qti-dfs \
"

# Disable compilation temporarily
CORE_IMAGE_BASE_INSTALL_remove += " \
    tdk-chx01-get-data-app \
    tdk-hvc4223f-scripts \
    tdk-thermistor-app \
"
```

## conf/machine/qrb5165-rb5.conf
```bitbake
#@TYPE: Machine
#@NAME: qrb5165-rb5 dev kit
#@DESCRIPTION: Machine configuration for RB5 dev kit based on QRB5165

require conf/machine/include/qrb5165.inc

KERNEL_IMAGETYPE   = "Image.gz"
KERNEL_DTB_NAMES   = "vendor/qcom/kona-v2.1-iot-rb5.dtb vendor/qcom/kona-v2.1-qrd.dtb vendor/qcom/kona-v2-qrd.dtb vendor/qcom/kona-v2-mtp.dtb vendor/qcom/kona-v2.1-mtp.dtb vendor/qcom/qrb5165-iot-rb5.dtb vendor/qcom/qrb5165m-iot-rb5.dtb vendor/qcom/qrb5165n-iot-rb5.dtb vendor/qcom/qrb5165n-v2-iot-rb5.dtb vendor/qcom/kona-7230-iot-rb5.dtb vendor/qcom/kona-7230m-iot-rb5.dtb vendor/qcom/qrb5165-iot-rb5-camslot5.dtb"
KERNEL_BASE        = "0x80000000"
KERNEL_TAGS_OFFSET = "0x81900000"

KERNEL_CONFIG     ?= "vendor/kona-perf_defconfig"
KERNEL_CONFIG_qti-distro-debug ?= "vendor/kona_defconfig"

CONSOLE_PARAM     ?= ""
CONSOLE_PARAM_qti-distro-debug ?= "console=ttyMSM0,115200,n8"

KERNEL_CMD_PARAMS  = "noinitrd ${CONSOLE_PARAM} earlycon=msm_geni_serial,0xa90000 androidboot.hardware=qcom androidboot.console=ttyMSM0 androidboot.memcg=1 lpm_levels.sleep_disabled=1 video=vfb:640x400,bpp=32,memsize=3072000 msm_rtb.filter=0x237 service_locator.enable=1 androidboot.usbcontroller=a600000.dwc3 swiotlb=2048 loop.max_part=7 cgroup.memory=nokmem,nosocket reboot=panic_warm net.ifnames=0"
ENABLE_ABL_SAFESTACK = "True"
ENABLE_SAFESTACK_SUPPORTED_CLANG_VERSION = "6.0"
SERIAL_CONSOLE    ?= ""
SERIAL_CONSOLE_qti-distro-debug ?= "115200 ttyMSM0"

# bootloader configuration
EXTRA_IMAGEDEPENDS += "edk2"

PREFERRED_PROVIDER_virtual/libgles1 = "adreno"
PREFERRED_PROVIDER_virtual/libgles2 = "adreno"
PREFERRED_PROVIDER_virtual/egl      = "adreno"

# Conf with partition entries required for machine.
MACHINE_PARTITION_CONF = "qrb5165-rb5-partition.conf"

# filesystem configurations to be applied on image.
MACHINE_FSCONFIG_CONF = "qrb5165-fsconfig.conf"

# File indicating firmware residing places on device.
MACHINE_FILESMAP_CONF = "kona-filesmap"

# Sizes for EXT4 (in bytes)
SYSTEM_SIZE_EXT4 = "8589934592"
USERDATA_SIZE_EXT4 = "103079215104"

# MACHINE_FEATURES ##
# emmc-boot:            Machine supports eMMC device
# ubwc:                 Machine supports UBWC hardware
# qti-wifi:             Machine supports QTI WiFi solution
# qti-audio:            Machine supports QTI audio solution
# qti-audio-encoder:    Machine supports QTI audio encoder
# qti-audio-cal:        Machine supports QTI audio calibration solution
# qti-adsp:             Machine supports QTI adsp solution
# qti-cvp:               Machine supports QTI cvp solution
# qti-ab-boot:          Machine support a/b boot
# opencl:               Machine supports OpenCL driver
# qti-tflite-delegate:  Machine supports tensorflow lite hardware acceleration
# drm :                 Machine supports DRM display drivers
# dm-verity-bootloader: Machine supports bootloader-based dm-verity implementation
# qti-security:         Support QTI security solution
# qti-gst-ros2:         Machine supports QTI Gst Ros2 solution
# qti-fscrypt:          Machine supports FBE using fscrypt

MACHINE_FEATURES += "emmc-boot ubwc qti-wifi hasting qti-adsp qti-audio qti-audio-encoder \
                     qti-audio-cal qti-ab-boot qti-cdsp qti-cvp opencl qti-tflite-delegate \
                     qti-camera drm qti-npu qti-security qti-gst-ros2 dm-verity-bootloader \
                     qti-slpi qti-sensors qti-fscrypt tdk-sensors qti-display"
```

## conf/machine/qrbx210-rbx.conf
```bitbake
#@TYPE: Machine
#@NAME: qrbx210-rbx
#@DESCRIPTION: Machine configuration for qrbx210-rbx

require conf/machine/include/qrbx210.inc

KERNEL_IMAGETYPE = "Image.gz"
KERNEL_DTB_NAMES = "vendor/qcom/qrb2210-rb1.dtb vendor/qcom/qrb2210-rb1-v2.dtb vendor/qcom/qrb4210-rb2.dtb vendor/qcom/qrb4210-rb2-v2.dtb"
KERNEL_BASE        = "0x00000000"
KERNEL_TAGS_OFFSET = "0x01E00000"

KERNEL_CONFIG ?= "vendor/bengal-qgki_defconfig"
TARGET_BUILD_VARIANT ?= "user"
KERNEL_CONFIG_qti-distro-debug ?= "vendor/bengal-qgki-debug_defconfig"
TARGET_BUILD_VARIANT_qti-distro-debug ?= "debug"

KERNEL_CMD_PARAMS = "console=ttyMSM0,115200,n8 earlycon=msm_geni_serial,0x4a90000 rootwait androidboot.hardware=qcom androidboot.console=ttyMSM0 systemd.setenv="SLOT_SUFFIX"="_a" androidboot.memcg=1 lpm_levels.sleep_disabled=1 video=vfb:640x400,bpp=32,memsize=3072000 msm_rtb.filter=0x237 service_locator.enable=1 swiotlb=2048 loop.max_part=7 firmware_class.path=/lib/firmware/updates"

KERNEL_DYNAMIC_DEFCONFIG = "True"

# bootloader configuration
EXTRA_IMAGEDEPENDS += "edk2"

# Conf with partition entries required for machine.
MACHINE_PARTITION_CONF = "qrbx210-rbx-partition.conf"

# filesystem configurations to be applied on image.
MACHINE_FSCONFIG_CONF = "qrbx210-fsconfig.conf"

# File indicating firmware residing places on device.
MACHINE_FILESMAP_CONF = "bengal-filesmap"

# Sizes for EXT4 (in bytes)
SYSTEM_SIZE_EXT4 = "3221225472"
USERDATA_SIZE_EXT4 = "4294967296"

#list of hardware features that MACHINE is capable of supporting
MACHINE_FEATURES += "emmc-boot dm-verity-bootloader qti-bluetooth qti-wifi qti-ab-boot qti-display qti-audio drm qti-adsp qti-cdsp qti-camera qti-sensors qti-security qti-fscrypt qti-gst-ros2 tdk-sensors"
```

## conf/machine/sa2150p-nand.conf
```bitbake
#@TYPE: Machine
#@NAME: SA2150P-NAND
#@DESCRIPTION: Machine configuration for QTI SA2150P-NAND

require conf/machine/include/sa2150p-base.inc

KERNEL_CONFIG ?= "vendor/sa2150p-qgki_defconfig"
KERNEL_CONFIG_qti-distro-debug ?= "vendor/sa2150p-qgki-debug_defconfig"
KERNEL_CMD_PARAMS = "noinitrd ro rootwait console=ttyMSM0,115200,n8 no_console_suspend=1 androidboot.hardware=qcom androidboot.console=ttyMSM0 lpm_levels.sleep_disabled=1 service_locator.enable=1 firmware_class.path=/lib/firmware/updates msm_rtb.filter=0x237"
KERNEL_DTB_NAMES    = "vendor/qcom/sa2150p-ccard-nand.dtb"

MACHINE_FEATURES += "nand-boot dm-verity-none qti-recovery"

MACHINE_MNT_POINTS = " \
    /firmware \
    /persist \
    /cache \
    /data \
    /systemrw \
"

# Formats of root filesystem images
IMAGE_FSTYPES = "ubi"

# Sizes for UBI volumes
SYSTEM_VOLUME_SIZE   = "150MiB"
CACHE_VOLUME_SIZE    = "81MiB"
SYSTEMRW_VOLUME_SIZE = "6MiB"
PERSIST_VOLUME_SIZE  = "12MiB"

UBINIZE_ARGS = "-m 4096 -p 256KiB -s 4096"
MKUBIFS_ARGS = "-m 4096 -e 253952 -c 2146 -F"

# File indicating firmware residing places on device.
MACHINE_FILESMAP_CONF = "sa2150p-nand-filesmap"
```

## conf/machine/sa2150p.conf
```bitbake
#@TYPE: Machine
#@NAME: SA2150P
#@DESCRIPTION: Machine configuration for QTI SA2150P

require conf/machine/include/sa2150p-base.inc

KERNEL_CONFIG ?= "vendor/sa2150p-qgki_defconfig"
KERNEL_CONFIG_qti-distro-debug ?= "vendor/sa2150p-qgki-debug_defconfig"
KERNEL_CMD_PARAMS = "noinitrd ro rootwait console=ttyMSM0,115200,n8 no_console_suspend=1 androidboot.hardware=qcom androidboot.console=ttyMSM0 systemd.setenv="SLOT_SUFFIX"="_a" lpm_levels.sleep_disabled=1 service_locator.enable=1 firmware_class.path=/lib/firmware/updates msm_rtb.filter=0x237"
KERNEL_DTB_NAMES    = "vendor/qcom/sa2150p-ccard-emmc.dtb"

MACHINE_FEATURES += "dm-verity-bootloader qti-ab-boot"

MACHINE_MNT_POINTS = " \
    /dsp \
    /firmware \
    /overlay \
    /persist \
"

# Sizes for EXT4 (in bytes)
SYSTEM_SIZE_EXT4   = "681574400"
SYSTEMRW_SIZE_EXT4 = "8388608"
USERDATA_SIZE_EXT4 = "5000000000"
CACHE_SIZE_EXT4    = "80000000"

MACHINE_FSCONFIG_CONF = "sa2150p-fsconfig.conf"

# File indicating firmware residing places on device.
MACHINE_FILESMAP_CONF = "sa2150p-filesmap"

# Enable qti-ab-boot feature without OTA package
GENERATE_AB_OTA_PACKAGE = "0"
```

## conf/machine/sa410m-fotavm.conf
```bitbake
#@TYPE: Machine
#@NAME: SA410M-FOTAVM
#@DESCRIPTION: Machine configuration for QTI TELEMATICS FOTAVM on SA410M

BASEMACHINE ?= "sa410m"

require conf/machine/include/telematics-vm.inc

KERNEL_BASE = "0x0"
KERNEL_OFFSET = "0"
DTB_OFFSET = "0x2000000"
RAMDISK_OFFSET = "0x2100000"

KERNEL_PREBUILT_PATH = "${WORKSPACE}/kernel-5.15/out/msm-kernel-sa410m_fotavm-${KERNEL_VARIANT}defconfig/dist"
KERNEL_OUT_PATH = "${WORKSPACE}/kernel-5.15/out/msm-kernel-sa410m_fotavm-${KERNEL_VARIANT}defconfig"
KERNEL_BUILD_CONFIG = "msm-kernel/build.config.msm.sa410m.fotavm"

KERNEL_DTB_NAMES    = "vendor/qcom/sa410m-fotavm.dtb"
DTB_TARGET = "vm.dtb"

KERNEL_CONFIG = "vendor/sa410m_fotavm_defconfig"
KERNEL_CONFIG_qti-distro-debug = "vendor/sa410m_fotavm-debug_defconfig"

MACHINE_FEATURES += "qti-vm-fota"

# Ramdisk size is 8 MB
RAMDISK_SIZE = "8388608"

#80MB
SYSTEM_SIZE_EXT4 ?= "83886080"

#112MB
VM_SIZE_EXT4 ?= "117440512"

VM_IMAGE_NAME="fotavm"
VMIMAGE_FLAVOR = "fotavm"

# filesystem configurations to be applied on image.
MACHINE_FSCONFIG_CONF = "sa410m-fsconfig.conf"
```

## conf/machine/sa410m-nand.conf
```bitbake
#@TYPE: Machine
#@NAME: SA410M-NAND
#@DESCRIPTION: Machine configuration for QTI SA410M NAND

require conf/machine/include/sa410m.inc

# MACHINE_FEATURES ##
MACHINE_FEATURES += "nand-boot"

# Formats of root filesystem images
IMAGE_FSTYPES = "ubi"

# Sizes for UBI volumes
SYSTEM_VOLUME_SIZE   = "150MiB"
CACHE_VOLUME_SIZE    = "15MiB"
SYSTEMRW_VOLUME_SIZE = "6MiB"
PERSIST_VOLUME_SIZE  = "6MiB"

# UBI arguments
UBINIZE_ARGS = "-m 4096 -p 256KiB -s 4096"
MKUBIFS_ARGS = "-m 4096 -e 253952 -c 2146 -F"

SDCARD_DEVICE = "mmcblk0p1"

# File indicating firmware residing places on device.
MACHINE_FILESMAP_CONF = "sa410m-nand-filesmap"
```

## conf/machine/sa410m-televm.conf
```bitbake
#@TYPE: Machine
#@NAME: SA410M-TELEVM
#@DESCRIPTION: Machine configuration for QTI TELEMATICS TELEVM on SA410M

BASEMACHINE ?= "sa410m"

require conf/machine/include/telematics-vm.inc

KERNEL_BASE = "0x0"
KERNEL_OFFSET = "0"
DTB_OFFSET = "0x2000000"
RAMDISK_OFFSET = "0x2100000"

KERNEL_PREBUILT_PATH = "${WORKSPACE}/kernel-5.15/out/msm-kernel-sa410m_televm-${KERNEL_VARIANT}defconfig/dist"
KERNEL_OUT_PATH = "${WORKSPACE}/kernel-5.15/out/msm-kernel-sa410m_televm-${KERNEL_VARIANT}defconfig"
KERNEL_BUILD_CONFIG = "msm-kernel/build.config.msm.sa410m.televm"

KERNEL_DTB_NAMES    = "vendor/qcom/sa410m-televm.dtb"
DTB_TARGET = "vm.dtb"

VM_IMAGE_NAME = "televm"
VMIMAGE_FLAVOR = "televm"

KERNEL_CONFIG = "vendor/sa410m_televm_defconfig"
KERNEL_CONFIG_qti-distro-debug = "vendor/sa410m_televm-debug_defconfig"

MACHINE_FEATURES += "qti-vm-tele"

# Ramdisk size is 8 MB
RAMDISK_SIZE = "8388608"
# System size is 150MB
SYSTEM_SIZE_EXT4 ?= "157286400"
# VM size is 183MB
VM_SIZE_EXT4 ?= "191889408"

# filesystem configurations to be applied on image.
MACHINE_FSCONFIG_CONF = "sa410m-fsconfig.conf"

MACHINE_SUPPORTS_SECUREMSM = "True"
```

## conf/machine/sa410m.conf
```bitbake
#@TYPE: Machine
#@NAME: SA410M
#@DESCRIPTION: Machine configuration for QTI SA410M EMMC

require conf/machine/include/sa410m.inc

# MACHINE_FEATURES ##
MACHINE_FEATURES += "qti-ab-boot emmc-boot"

# Sizes for EXT4 (in bytes)
SYSTEM_SIZE_EXT4   = "536870912"
USERDATA_SIZE_EXT4 = "4294967296"
CACHE_SIZE_EXT4 = "31457280"

SDCARD_DEVICE = "mmcblk1p1"

# Formats of root filesystem images
IMAGE_FSTYPES += "ext4"

# filesystem configurations to be applied on image.
MACHINE_FSCONFIG_CONF = "sa410m-fsconfig.conf"

# File indicating firmware residing places on device.
MACHINE_FILESMAP_CONF = "sa410m-filesmap"

# Conf with partition entries required for machine.
MACHINE_PARTITION_CONF = "sa410m-partition.conf"
```
