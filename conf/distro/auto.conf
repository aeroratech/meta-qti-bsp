## conf/distro/qti-distro-xr-debug.conf
```bitbake
#######################################################################################
#@TYPE: Distribution
#@NAME: qti-distro-xr-debug
#@DESCRIPTION: Qualcomm Technologies Incorporated Reference Linux Distribution
# (glibc based) for extended reality having debugging capabilities. Not optimized for
# performance. Allows root user access.
#
# Supported DISTROOVERRIDES are
#  * qti-distro-base            - provision for base distro variable overrides
#  * qti-distro-debug           - provision for debug distro variable overrides
#  * qti-distro-xr-debug        - provision for xr-debug distro variable overrides
#
# For same variable override precedence order is
# qti-distro-xr-debug > qti-distro-debug > qti-distro-base
#######################################################################################

# Honor qti-distro-debug override
DISTROOVERRIDES =. "qti-distro-debug:"

require conf/distro/include/qti-distro-xr.inc

DISTRO_NAME = "QTI Linux reference extended reality distro with debug capabilities."

# Set DEBUG_BUILD to use flags from DEBUG_OPTIMIZATION variable
DEBUG_BUILD = "1"

# Bring in debug utilities.
DISTRO_EXTRA_RDEPENDS += "packagegroup-qti-debug-tools"

#enable systemd journal
SYSTEMD_ENABLE_JOURNAL = "1"
```

## conf/distro/qti-distro-xr-perf.conf
```bitbake
#######################################################################################
#@TYPE: Distribution
#@NAME: qti-distro-xr-perf
#@DESCRIPTION: Qualcomm Technologies Incorporated Reference Linux Distribution
# (glibc based) for extended reality with performance orientation. Serial console and
# a few debug features in base distro are disabled. Uses a kernel config targeting faster
# bootup and performance. Allows root user access.
#
# Supported DISTROOVERRIDES are
#  * qti-distro-base           - provision for base distro variable overrides
#  * qti-distro-perf           - provision for perf distro variable overrides
#  * qti-distro-xr-perf        - provision for xr-perf distro variable overrides
#
# For same variable override precedence order is
# qti-distro-xr-perf > qti-distro-perf > qti-distro-base
#######################################################################################

# Honor qti-distro-perf override
DISTROOVERRIDES =. "qti-distro-perf:"

require conf/distro/include/qti-distro-xr.inc

DISTRO_NAME = "QTI Linux reference extended reality distro targeting performance builds."


# Bring in debug utilities.
DISTRO_EXTRA_RDEPENDS += "packagegroup-qti-debug-tools"
```

## conf/layer.conf
```bitbake
BBPATH .= ":${LAYERDIR}"

BBFILE_COLLECTIONS        += "qti-bsp"
BBFILE_PRIORITY_qti-bsp    = "10"
BBFILE_PATTERN_qti-bsp    := "^${LAYERDIR}/"

LAYERSERIES_COMPAT_qti-bsp = "dunfell"

LICENSE_PATH += "${LAYERDIR}/files/common-licenses"

# Set a variable to get to the top of the metadata location
QTIBASE = '${@os.path.normpath("${LAYERDIR}/")}'

# Tools needed on the build host for usage within build tasks by recipes of this layer.
HOSTTOOLS_NONFATAL += "xgettext msgmerge msgfmt gmsgfmt java zip"

BBFILES += " ${LAYERDIR}/recipes-*/*/*.bb \
             ${LAYERDIR}/recipes-*/*/*.bbappend"
```
