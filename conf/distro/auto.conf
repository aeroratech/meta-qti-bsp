## conf/distro/auto.conf
```bitbake
BASEDISTRO ?= "mdm"

require conf/distro/mdm.conf

DISTRO_NAME = "auto"
DISTROOVERRIDES =. "${MACHINE}-auto:"

PRODUCT = "auto"

KERNEL_CONFIG = "${@['${MACHINE}-auto-perf_defconfig', '${MACHINE}-auto_defconfig'][d.getVar('VARIANT', True) == ('' or 'debug')]}"

DISTRO_FEATURES += "early-eth"
DISTRO_FEATURES += " selinux"
DISTRO_FEATURES_FILTER_NATIVE  += " selinux"
DEFAULT_ENFORCING = "enforcing"

#Volume sizes
SYSTEM_VOLUME_SIZE = "90MiB"
CACHE_VOLUME_SIZE = "100MiB"
SYSTEMRW_VOLUME_SIZE = "6MiB"
PERSIST_VOLUME_SIZE = "6MiB"

# Formats of root filesystem images.
IMAGE_FSTYPES = "ubi"

# Use systemd init manager.
DISTRO_FEATURES_remove = "sysvinit"
DISTRO_FEATURES_append = " systemd"
DISTRO_FEATURES_BACKFILL_CONSIDERED += "sysvinit"
VIRTUAL-RUNTIME_dev_manager = "udev"
VIRTUAL-RUNTIME_init_manager = "systemd"

# Change Image features for systemd.
IMAGE_DEV_MANAGER = "udev"
IMAGE_INIT_MANAGER = "systemd"
IMAGE_INITSCRIPTS = ""

INCOMPATIBLE_LICENSE += "GPL-3.0 LGPL-3.0 AGPL-3.0"
WHITELIST_GPL-3.0 += "bash coreutils gawk gdb gdbm gettext m4 readline findutils grep elfutils"
PACKAGE_EXCLUDE += "bash gawk gdbm gettext m4 readline elfutils"
```

## conf/distro/include/qti-distro-base.inc
```bitbake
######################################################################
# This configuration defines an OE Linux based distribution containing
# basic libraries and utilities like libc, busybox, systemd, udev and
# a few init scripts required for running the system on qti chipsets.
######################################################################

# Pull in security flags
require ${COREBASE}/meta-qti-bsp/conf/distro/include/security_flags.inc

# DISTRO CONFIGURATION
DISTRO_VERSION ?= "${BUILDNAME}"

DISTROOVERRIDES =. "qti-distro-base:"

# DISTRO FEATURE SELECTION
MICRO_GOLD ?= "ld-is-gold"

USE_DEVFS = "0"

# Use Debian naming scheme for library (.so) files
INHERIT += "recipe_sanity"

# TOOLCHAIN
PREFERRED_VERSION_autoconf = "2.68"
ARM_INSTRUCTION_SET       ?= "arm"

######################################################################
# Optimization flags.
######################################################################
COMMON_OPTIMIZATION = " \
  -g -Wa,--noexecstack -fexpensive-optimizations \
  -frename-registers -ftree-vectorize \
  -finline-functions -finline-limit=64 \
  -Wno-error=maybe-uninitialized -Wno-error=unused-result \
"

FULL_OPTIMIZATION  = " -O2 ${COMMON_OPTIMIZATION} "
DEBUG_OPTIMIZATION = " ${FULL_OPTIMIZATION} "

# NLS
USE_NLS = "no"
USE_NLS_glib-2.0 = "yes"
USE_NLS_glib-2.0-native = "yes"
USE_NLS_gcc-cross = "no"

# Disable GIO module cache creation
GIO_MODULE_PACKAGES=""

# Disable binary locale generation
ENABLE_BINARY_LOCALE_GENERATION = "0"

#Allow library symlinks to exist alongside soname files
PACKAGE_SNAP_LIB_SYMLINKS = "0"

# Don't install ldconfig and associated gubbins
USE_LDCONFIG = "0"
LDCONFIGDEPEND = ""
COMMERCIAL_LICENSE_DEPENDEES = ""

# Directory structure for distro images.
DEPLOY_NAME      ?= "${MACHINE}-${DISTRO}"
DEPLOY_DIR_IMAGE  = "${DEPLOY_DIR}/images/${DEPLOY_NAME}"

# Add qti custom user permissions
USERADDEXTENSION = "qpermissions"

##################################################################
# list of distro features
##################################################################
# eabi:       Embedded Application Binary Interface(EABI).
# ipv4,ipv6:  Basic networking tools - ipv6,ipv4.
# largefile:  LargeFile support in Linux.
# selinux:    Use selinux for mandatory access control.
# systemd:    Use systemd init manager.
# thumb-interwork: Linker can detect thumb function called from ARM
#             state and alter call, return sequences etc to change
#             processor state as necessary.
# xattr:      Extended attributes(xattr) to filesystem.
DISTRO_FEATURES   += " selinux systemd eabi ipv6 ipv4 largefile thumb-interwork xattr ${DISTRO_FEATURES_LIBC}"

## QTI Defined distro features ##
# emmc-boot:  Support eMMC device
# qti-wifi:   Support QTI WiFi solution
#
DISTRO_FEATURES   += " emmc-boot qti-wifi"

# Set selinux in disabled state
DEFAULT_ENFORCING ?= "disabled"

# Consider sysVinit for backfilling systemd.
DISTRO_FEATURES_BACKFILL_CONSIDERED += "sysvinit"
VIRTUAL-RUNTIME_dev_manager = "udev"
VIRTUAL-RUNTIME_init_manager = "systemd"

# Change Image features for systemd.
IMAGE_DEV_MANAGER = "udev"
IMAGE_INIT_MANAGER = "systemd"
IMAGE_INITSCRIPTS = ""

RM_WORK_EXCLUDE += "make-mod-scripts"
```

## conf/distro/include/qti-distro-fullstack.inc
```bitbake
######################################################################
# This configuration defines an OE Linux based distribution containing
# full reference stack for running the system on qti chipsets.
######################################################################

# Get basic distro configuration
require conf/distro/include/qti-distro-base.inc

DISTRO_NAME = "QTI Linux full refrence stack distro."

##################################################################
# list of distro features
##################################################################
#
# drm:             Use DRM display drivers, provided machine supports it.
# dm-verity:       Support block integrity check on system image
# fbdev:           Use FBDEV display drivers, provided machine supports it.
# opencl:          Include the Open Computing Language
# opengl:          Include the Open Graphics Library,
# pulseaudio:      Use pulseaudio audio server
# selinux:         Use selinux for mandatory access control.
# tensorflow-lite: Include the tensorflow lite inference engine.
# wayland:         Include the Wayland display server protocol.

DISTRO_FEATURES_append = " drm dm-verity fbdev opencl opengl pulseaudio selinux tensorflow-lite wayland"

## QTI defined distro features ##
# qti-audio:     Support QTI audio solution
# qti-bluetooth: Support QTI bluetooth solution
# qti-camera:    Support QTI camera solution
# qti-mm-parser: Support QTI multimeida parsers
# qti-video:     Support QTI video solution
# qti-video-encoder: Support QTI video encode
# qti-cdsp:      Support QTI cdsp solution
# qti-adsp:      Support QTI adsp solution
# qti-qmmf:      Support QTI QMMF solution
# qti-security:  Support QTI security solution
# qti-vble:      Support QTI Verified boot for LE
#

DISTRO_FEATURES_append = " qti-audio qti-bluetooth qti-camera qti-mm-parser qti-video qti-video-encoder qti-cdsp qti-adsp qti-fastcv qti-qmmf qti-security qti-vble "

# inherit distro_featres_check class across the distro
INHERIT += "distro_features_check"

# Include in native DISTRO_FEATURES if present in the target DISTRO_FEATURES.
DISTRO_FEATURES_FILTER_NATIVE += " selinux"

# Set selinux in enforcing state by default
DEFAULT_ENFORCING = "enforcing"
```

## conf/distro/include/qti-distro-modem.inc
```bitbake
######################################################################
# This configuration defines an OE Linux based distribution containing
# reference stack for running modem on qti chipsets.
######################################################################

# Get basic distro configuration
require conf/distro/include/qti-distro-base.inc

DISTRO_NAME = "QTI Linux modem distro."

# inherit distro_featres_check class across the distro
INHERIT += "distro_features_check"

# Add Incompatible license details
INCOMPATIBLE_LICENSE += "GPL-3.0 LGPL-3.0 AGPL-3.0"
WHITELIST_GPL-3.0 += "coreutils gettext bash grep m4 findutils elfutils gdbm readline"
PACKAGE_EXCLUDE += "gdb gdbserver gdbm gettext m4 elfutils readline"
```

## conf/distro/include/qti-distro-nogplv3.inc
```bitbake
######################################################################
# This configuration defines an OE Linux based distribution containing
# reference stack for running nogplv3 on qti chipsets.
######################################################################

# Get basic distro configuration
require conf/distro/include/qti-distro-base.inc

DISTRO_NAME = "QTI Linux nogplv3 distro."

# inherit distro_featres_check class across the distro
INHERIT += "distro_features_check"

# Add Incompatible license details
INCOMPATIBLE_LICENSE += "GPL-3.0 LGPL-3.0 AGPL-3.0"

WHITELIST_GPL-3.0 += "bash gettext elfutils gdbm  readline m4"
PACKAGE_EXCLUDE +=   "bash gettext elfutils gdbm  readline m4"
```

## conf/distro/include/qti-distro-xr.inc
```bitbake
######################################################################
# This configuration defines an OE Linux based distribution containing
# reference stack for running extended reality on qti chipsets.
######################################################################

# Get basic distro configuration
require conf/distro/include/qti-distro-base.inc

DISTRO_NAME = "QTI Linux extended realit distro."

##################################################################
# list of distro features
##################################################################
#
# drm:             Use DRM display drivers, provided machine supports it.
# fbdev:           Use FBDEV display drivers, provided machine supports it.
# opencl:          Include the Open Computing Language
# opengl:          Include the Open Graphics Library,
# pulseaudio:      Use pulseaudio audio server
# wayland:         Include the Wayland display server protocol.

DISTRO_FEATURES_append = " drm fbdev opencl opengl pulseaudio wayland"

## QTI defined distro features ##
# qti-audio-cal: Support QTI audio calibration solution
# qti-audio-encoder: Support QRI audio encoder
# qti-bluetooth: Support QTI bluetooth solution
# qti-camera:    Support QTI camera solution
# qti-mm-parser: Support QTI multimeida parsers
# qti-video-encoder: Support QTI video encode
# qti-adsp:      Support QTI adsp solution
# qti-security:      Support QTI security solution
#

DISTRO_FEATURES_append = " qti-audio-cal qti-audio-encoder qti-bluetooth qti-camera qti-mm-parser qti-video-encoder qti-adsp qti-security "

# inherit distro_featres_check class across the distro
INHERIT += "distro_features_check"

# Set selinux in disabled state
DEFAULT_ENFORCING ?= "disabled"
```

## conf/distro/qti-base.conf
```bitbake
#######################################################################################
#@TYPE: Distribution
#@NAME: qti-base
#@DESCRIPTION: Qualcomm Technologies Incorporated Base Linux Distribution (glibc based)
#######################################################################################
require conf/distro/include/base.inc

# Pull in security flags
require ${COREBASE}/meta-qti-bsp/conf/distro/include/security_flags.inc

#Pull in debug packaging flags
include ${COREBASE}/meta-qti-bsp/conf/distro/include/debug_flags.inc

# DISTRO CONFIGURATION
DISTRO_VERSION ?= "${BUILDNAME}"

BASEDISTRO  = "qti-base"
DISTRO_NAME = "qti-base"

# Set DEBUG_BUILD ="1" to make builds with debug symbols.
DEBUG_BUILD ?= "0"

# list of distro features
# emmc storage.
DISTRO_FEATURES += "emmc-boot"

# Enables wlan software stack
DISTRO_FEATURES += "wlan"

#selinux in disabled state
DEFAULT_ENFORCING = "disabled"
```

## conf/distro/qti-distro-base-nosecurity.conf
```bitbake
#######################################################################################
#@TYPE: Distribution
#@NAME: qti-distro-base-nosecurity
#@DESCRIPTION: Qualcomm Technologies Incorporated Base Linux Distribution (glibc based)
# with performance and security orientation. Serial console and other debug features in base
# line distro are disabled. Uses a kernel config targeting faster bootup and performance.
# Also root user privileges are disabled.
#
# Supported DISTROOVERRIDES are
#  * qti-distro-base            - provision for base distro variable overrides
#  * qti-distro-base-nosecurity - provision for base-nosecurity distro variable overrides
#
# For same variable override qti-distro-base-nosecurity takes precedence over qti-distro-base.
#######################################################################################

require conf/distro/include/qti-distro-base.inc

DISTRO_NAME = "QTI Linux distro targeting basic builds without security features support."

# Bring in debug utilities.
DISTRO_EXTRA_RDEPENDS += "packagegroup-qti-debug-tools"

DISTRO_FEATURES_remove = "selinux"
```

## conf/distro/qti-distro-debug.conf
```bitbake
#######################################################################################
#@TYPE: Distribution
#@NAME: qti-distro-debug
#@DESCRIPTION: Qualcomm Technologies Incorporated Base Linux Distribution (glibc based)
# with debugging capabilities. Not optimized for performance. Allows root user access.
#
# Supported DISTROOVERRIDES are
#  * qti-distro-base  - provision for base distro variable overrides
#  * qti-distro-debug - provision for debug distro variable overrides
#
# For same variable override qti-distro-debug takes precedence over qti-distro-base.
#######################################################################################

require conf/distro/include/qti-distro-base.inc

DISTRO_NAME = "QTI Linux distro with debug capabilities."

# Set DEBUG_BUILD to use flags from DEBUG_OPTIMIZATION variable
DEBUG_BUILD = "1"

# Bring in debug utilities.
DISTRO_EXTRA_RDEPENDS += "packagegroup-qti-debug-tools"

#enable systemd journal
SYSTEMD_ENABLE_JOURNAL = "1"
```

## conf/distro/qti-distro-fullstack-debug.conf
```bitbake
#######################################################################################
#@TYPE: Distribution
#@NAME: qti-distro-fullstack-debug
#@DESCRIPTION: Qualcomm Technologies Incorporated Full Reference Stack Linux Distribution
# (glibc based) having debugging capabilities. Not optimized for performance.
# Allows root user access.
#
# Supported DISTROOVERRIDES are
#  * qti-distro-base            - provision for base distro variable overrides
#  * qti-distro-debug           - provision for debug distro variable overrides
#  * qti-distro-fullstack-debug - provision for fullstack-debug distro variable overrides
#
# For same variable override precedence order is
# qti-distro-fullstack-debug > qti-distro-debug > qti-distro-base
#######################################################################################

# Honor qti-distro-debug override
DISTROOVERRIDES =. "qti-distro-debug:"

require conf/distro/include/qti-distro-fullstack.inc

DISTRO_NAME = "QTI Linux full reference stack distro with debug capabilities."

# Set DEBUG_BUILD to use flags from DEBUG_OPTIMIZATION variable
DEBUG_BUILD = "1"

# Bring in gdbserver, strace utilities.
DISTRO_EXTRA_RDEPENDS += "packagegroup-qti-debug-tools"

#enable systemd journal
SYSTEMD_ENABLE_JOURNAL = "1"
```
