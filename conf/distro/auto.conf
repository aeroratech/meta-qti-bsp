## conf/distro/qti-distro-fullstack-iotedge-debug.conf
```bitbake
#######################################################################################
#@TYPE: Distribution
#@NAME: qti-distro-fullstack-iotedge-debug
#@DESCRIPTION: Qualcomm Technologies Incorporated Full Reference Stack Linux Distribution
# (glibc based) having debugging capabilities with iotedge support.
# Not optimized for performance. Allows root user access.
#
# Supported DISTROOVERRIDES are
#  * qti-distro-base            - provision for base distro variable overrides
#  * qti-distro-debug           - provision for debug distro variable overrides
#  * qti-distro-fullstack-iotedge-debug - provision for fullstack-debug distro variable overrides
#
# For same variable override precedence order is
# qti-distro-fullstack-iotedge-debug > qti-distro-debug > qti-distro-base
#######################################################################################

# Honor qti-distro-debug override
DISTROOVERRIDES =. "qti-distro-debug:"

require conf/distro/include/qti-distro-fullstack.inc

DISTRO_NAME = "QTI Linux full reference stack distro with iotedge and debug capabilities."

# Enable virtualization
DISTRO_FEATURES += "virtualization"

# Set DEBUG_BUILD to use flags from DEBUG_OPTIMIZATION variable
DEBUG_BUILD = "1"

# Bring in debug utilities.
DISTRO_EXTRA_RDEPENDS += "packagegroup-qti-debug-tools"

#enable systemd journal
SYSTEMD_ENABLE_JOURNAL = "1"

# Enable coredump
SYSTEMD_ENABLE_COREDUMP = "1"
SYSTEMD_COREDUMP_PATH = "${userfsdatadir}/coredump"
```

## conf/distro/qti-distro-fullstack-noselinux-debug.conf
```bitbake
#######################################################################################
#@TYPE: Distribution
#@NAME: qti-distro-fullstack-noselinux-debug
#@DESCRIPTION: Qualcomm Technologies Incorporated Full Reference Stack Linux Distribution
# (glibc based) having debugging capabilities without selinux support.
# Not optimized for performance. Allows root user access.
#
# Supported DISTROOVERRIDES are
#  * qti-distro-base           - provision for base distro variable overrides
#  * qti-distro-debug          - provision for debug distro variable overrides
#  * qti-distro-fullstack-noselinux-debug - provision for noselinux distro variable overrides
#
# For same variable override precedence order is
# qti-distro-fullstack-noselinux-debug > qti-distro-debug > qti-distro-base
#######################################################################################

# Honor qti-distro-debug override
DISTROOVERRIDES =. "qti-distro-debug:"

require conf/distro/include/qti-distro-fullstack.inc

DISTRO_NAME = "QTI Linux full reference stack debug capable distro without selinux."

# Remove selinux distro feature defined in fullstack distro.
DISTRO_FEATURES_remove = "selinux"

# Set DEBUG_BUILD to use flags from DEBUG_OPTIMIZATION variable
DEBUG_BUILD = "1"

# Bring in debug utilities.
DISTRO_EXTRA_RDEPENDS += "packagegroup-qti-debug-tools"

#enable systemd journal
SYSTEMD_ENABLE_JOURNAL = "1"
```

## conf/distro/qti-distro-fullstack-noselinux-perf.conf
```bitbake
#######################################################################################
#@TYPE: Distribution
#@NAME: qti-distro-fullstack-noselinux-perf
#@DESCRIPTION: Qualcomm Technologies Incorporated Full Reference Stack Linux Distribution
# (glibc based) without selinux support having performance orientation. Serial console and
# a few debug features in base line distro are disabled. Uses a kernel config targeting 
# faster bootup and performance. Allows root user access.
#
# Supported DISTROOVERRIDES are
#  * qti-distro-base           - provision for base distro variable overrides
#  * qti-distro-perf           - provision for perf distro variable overrides
#  * qti-distro-fullstack-noselinux-perf - provision for noselinux distro variable overrides
#
# For same variable override precedence order is
# qti-distro-fullstack-noselinux-perf > qti-distro-perf > qti-distro-base
#######################################################################################

# Honor qti-distro-perf override
DISTROOVERRIDES =. "qti-distro-perf:"

require conf/distro/include/qti-distro-fullstack.inc

DISTRO_NAME = "QTI Linux full reference stack distro without selinux targeting performance builds."

# Remove selinux distro feature defined in fullstack distro.
DISTRO_FEATURES_remove = "selinux"

# Bring in debug utilities.
DISTRO_EXTRA_RDEPENDS += "packagegroup-qti-debug-tools"
```

## conf/distro/qti-distro-fullstack-perf.conf
```bitbake
#######################################################################################
#@TYPE: Distribution
#@NAME: qti-distro-fullstack-perf
#@DESCRIPTION: Qualcomm Technologies Incorporated Full Reference Stack Linux Distribution
# (glibc based) with performance orientation. Serial console and a few debug features in
# base line distro are disabled. Uses a kernel config targeting faster bootup and performance.
# Allows root user access.
#
# Supported DISTROOVERRIDES are
#  * qti-distro-base           - provision for base distro variable overrides
#  * qti-distro-perf           - provision for perf distro variable overrides
#  * qti-distro-fullstack-perf - provision for fullstack-perf distro variable overrides
#
# For same variable override precedence order is
# qti-distro-fullstack-perf > qti-distro-perf > qti-distro-base
#######################################################################################

# Honor qti-distro-perf override
DISTROOVERRIDES =. "qti-distro-perf:"

require conf/distro/include/qti-distro-fullstack.inc

DISTRO_NAME = "QTI Linux full reference stack distro targeting performance builds."

# Disable debug logs for lk package.
EXTRA_OEMAKE_append_pn-lk = " DISABLE_LOGGING_BL=1"
```

## conf/distro/qti-distro-fullstack-user.conf
```bitbake
#######################################################################################
#@TYPE: Distribution
#@NAME: qti-distro-fullstack-user
#@DESCRIPTION: Qualcomm Technologies Incorporated Full Reference Stack Linux Distribution
# (glibc based) having performance and security orientation. Serial console and other debug
# features in base line distro are disabled. Uses kernel config targeting faster bootup and
# performance. Also root user privileges are disabled.
#
# Supported DISTROOVERRIDES are
#  * qti-distro-base           - provision for base distro variable overrides
#  * qti-distro-user           - provision for user distro variable overrides
#  * qti-distro-fullstack-user - provision for fullstack-user distro variable overrides
#
# For same variable override precedence order is
# qti-distro-fullstack-user > qti-distro-user > qti-distro-base
#######################################################################################

# Honor qti-distro-user override
DISTROOVERRIDES =. "qti-distro-user:"

require conf/distro/include/qti-distro-fullstack.inc

DISTRO_NAME = "QTI Linux full reference stack distro intended for production"

# Disable debug logs for lk package.
EXTRA_OEMAKE_append_pn-lk = " DISABLE_LOGGING_BL=1 TARGET_BUILD_VARIANT=user"
```

## conf/distro/qti-distro-fullstack-virtualization-debug.conf
```bitbake
#######################################################################################
#@TYPE: Distribution
#@NAME: qti-distro-fullstack-virtualization-debug
#@DESCRIPTION: Qualcomm Technologies Incorporated Full Reference Stack Linux Distribution
# (glibc based) having debugging capabilities with virtualization support.
# Not optimized for performance. Allows root user access.
#
# Supported DISTROOVERRIDES are
#  * qti-distro-base            - provision for base distro variable overrides
#  * qti-distro-debug           - provision for debug distro variable overrides
#  * qti-distro-fullstack-virtualization-debug - provision for virtualization-debug distro
#                                 variable overrides
#
# For same variable override precedence order is
# qti-distro-fullstack-virtualization-debug > qti-distro-debug > qti-distro-base
#######################################################################################

# Honor qti-distro-debug override
DISTROOVERRIDES =. "qti-distro-debug:"

require conf/distro/include/qti-distro-fullstack.inc

DISTRO_NAME = "QTI Linux full reference stack distro with virtualization support and debug capabilities."

# Enable virtualization
DISTRO_FEATURES += "virtualization"

# Set DEBUG_BUILD to use flags from DEBUG_OPTIMIZATION variable
DEBUG_BUILD = "1"

# Bring in debug utilities.
DISTRO_EXTRA_RDEPENDS += "packagegroup-qti-debug-tools"

#enable systemd journal
SYSTEMD_ENABLE_JOURNAL = "1"

# Enable coredump
SYSTEMD_ENABLE_COREDUMP = "1"
SYSTEMD_COREDUMP_PATH = "${userfsdatadir}/coredump"
```

## conf/distro/qti-distro-modem-debug.conf
```bitbake
#######################################################################################
#@TYPE: Distribution
#@NAME: qti-distro-modem-debug
#@DESCRIPTION: Qualcomm Technologies Incorporated Reference Linux Distribution
# (glibc based) for modem having debugging capabilities. Not optimized for
# performance.
#
# Supported DISTROOVERRIDES are
#  * qti-distro-base            - provision for base distro variable overrides
#  * qti-distro-debug           - provision for debug distro variable overrides
#  * qti-distro-modem-debug     - provision for modem-debug distro variable overrides
#
# For same variable override precedence order is
# qti-distro-modem-debug > qti-distro-debug > qti-distro-base
#######################################################################################

# Honor qti-distro-debug override
DISTROOVERRIDES =. "qti-distro-debug:"

require conf/distro/include/qti-distro-modem.inc

DISTRO_NAME = "QTI Linux reference modem distro with debug capabilities."

# Set DEBUG_BUILD to use flags from DEBUG_OPTIMIZATION variable
DEBUG_BUILD = "1"

#enable systemd journal
SYSTEMD_ENABLE_JOURNAL = "1"
```

## conf/distro/qti-distro-modem-perf.conf
```bitbake
#######################################################################################
#@TYPE: Distribution
#@NAME: qti-distro-modem-perf
#@DESCRIPTION: Qualcomm Technologies Incorporated Reference Linux Distribution
# (glibc based) for modem with performance orientation. Serial console and
# a few debug features in base distro are disabled. Uses a kernel config targeting faster
# bootup and performance.
#
# Supported DISTROOVERRIDES are
#  * qti-distro-base           - provision for base distro variable overrides
#  * qti-distro-perf           - provision for perf distro variable overrides
#  * qti-distro-modem-perf     - provision for modem-perf distro variable overrides
#
# For same variable override precedence order is
# qti-distro-modem-perf > qti-distro-perf > qti-distro-base
#######################################################################################

# Honor qti-distro-perf override
DISTROOVERRIDES =. "qti-distro-perf:"

require conf/distro/include/qti-distro-modem.inc

DISTRO_NAME = "QTI Linux reference modem distro targeting performance builds."
```

## conf/distro/qti-distro-nogplv3-debug.conf
```bitbake
#######################################################################################
#@TYPE: Distribution
#@NAME: qti-distro-nogplv3-debug
#@DESCRIPTION: Qualcomm Technologies Incorporated Reference Linux Distribution
# (glibc based) for nogplv3 having debugging capabilities. Not optimized for
# performance.
#
# Supported DISTROOVERRIDES are
#  * qti-distro-base            - provision for base distro variable overrides
#  * qti-distro-debug           - provision for debug distro variable overrides
#  * qti-distro-nogplv3-debug     - provision for nogplv3-debug distro variable overrides
#
# For same variable override precedence order is
# qti-distro-nogplv3-debug > qti-distro-debug > qti-distro-base
#######################################################################################

# Honor qti-distro-debug override
DISTROOVERRIDES =. "qti-distro-debug:"

require conf/distro/include/qti-distro-nogplv3.inc

DISTRO_NAME = "QTI Linux reference nogplv3 distro with debug capabilities."

# Set DEBUG_BUILD to use flags from DEBUG_OPTIMIZATION variable
DEBUG_BUILD = "1"

#enable systemd journal
SYSTEMD_ENABLE_JOURNAL = "1"
```

## conf/distro/qti-distro-nogplv3-perf.conf
```bitbake
#######################################################################################
#@TYPE: Distribution
#@NAME: qti-distro-nogplv3-perf
#@DESCRIPTION: Qualcomm Technologies Incorporated Reference Linux Distribution
# (glibc based) for nogplv3 with performance orientation. Serial console and
# a few debug features in base distro are disabled. Uses a kernel config targeting faster
# bootup and performance.
#
# Supported DISTROOVERRIDES are
#  * qti-distro-base           - provision for base distro variable overrides
#  * qti-distro-perf           - provision for perf distro variable overrides
#  * qti-distro-nogplv3-perf     - provision for nogplv3-perf distro variable overrides
#
# For same variable override precedence order is
# qti-distro-nogplv3-perf > qti-distro-perf > qti-distro-base
#######################################################################################

# Honor qti-distro-perf override
DISTROOVERRIDES =. "qti-distro-perf:"

require conf/distro/include/qti-distro-nogplv3.inc

DISTRO_NAME = "QTI Linux reference nogplv3 distro targeting performance builds."
```

## conf/distro/qti-distro-perf.conf
```bitbake
#######################################################################################
#@TYPE: Distribution
#@NAME: qti-distro-perf
#@DESCRIPTION: Qualcomm Technologies Incorporated Base Linux Distribution (glibc based)
# with performance orientation. Serial console and a few debug features in base line
# distro are disabled. Uses a kernel config targeting faster bootup and performance.
# Allows root user access.
#
# Supported DISTROOVERRIDES are
#  * qti-distro-base - provision for base distro variable overrides
#  * qti-distro-perf - provision for perf distro variable overrides
#
# For same variable override qti-distro-perf takes precedence over qti-distro-base.
#######################################################################################

require conf/distro/include/qti-distro-base.inc

DISTRO_NAME = "QTI Linux distro targeting performance builds."

# Disable debug logs for lk package.
EXTRA_OEMAKE_append_pn-lk = " DISABLE_LOGGING_BL=1"

# Bring in debug utilities.
DISTRO_EXTRA_RDEPENDS += "packagegroup-qti-debug-tools"
```

## conf/distro/qti-distro-user.conf
```bitbake
#######################################################################################
#@TYPE: Distribution
#@NAME: qti-distro-user
#@DESCRIPTION: Qualcomm Technologies Incorporated Base Linux Distribution (glibc based)
# with performance and security orientation. Serial console and other debug features in base
# line distro are disabled. Uses a kernel config targeting faster bootup and performance.
# Also root user privileges are disabled.
#
# Supported DISTROOVERRIDES are
#  * qti-distro-base - provision for base distro variable overrides
#  * qti-distro-user - provision for user distro variable overrides
#
# For same variable override qti-distro-user takes precedence over qti-distro-base.
#######################################################################################

require conf/distro/include/qti-distro-base.inc

DISTRO_NAME = "QTI Linux distro intended for production."

# Disable debug logs for lk package.
EXTRA_OEMAKE_append_pn-lk = " DISABLE_LOGGING_BL=1 TARGET_BUILD_VARIANT=user"
```
